//3-axis stepper motor controller using the TMC429 ramp generator and three TMC2209 silent stepper motor drivers

#include <SPI.h>    //SPI Library
#include <TMC2209.h> //TMC2209 library - Stepper motor config
#include <TMC429.h> //TMC429 library - Ramp generator
#include <Wire.h> //i2C Library
#include <CommandParser.h> //CommandParser Library for parsing incoming UART command

//Instantiate the drivers for the 3 axes
const TMC2209::SerialAddress SERIAL_ADDRESS_0 = TMC2209::SERIAL_ADDRESS_0; //GND-GND
TMC2209 X_driver; //X axis driver and its address set via the MS1, MS2 pins
const TMC2209::SerialAddress SERIAL_ADDRESS_1 = TMC2209::SERIAL_ADDRESS_2; //VCC-GND 
TMC2209 Y_driver; //Y axis driver and its address set via the MS1, MS2 pins
const TMC2209::SerialAddress SERIAL_ADDRESS_2 = TMC2209::SERIAL_ADDRESS_1; //GND-VCC
TMC2209 Z_driver; //Z axis driver and its address set via the MS1, MS2 pins

TMC2209 driver_list[3] = {X_driver, Y_driver, Z_driver};

// Instantiate stepper controller - TMC 429
TMC429 stepper_controller;

//SPI on Teensy 4.0 vs. TMC429
//CS   10 - CSN_C
//MOSI 11 - SDI_C
//MISO 12 - SDO_C
//SCK  13 - SCK_C

//i2c on Teensy 4.0
//SDA 18
//SCL 19

HardwareSerial & serial_stream = Serial1; //1st UART port
//Unlike Arduino, Teensy has different Serial (USB) and Serial1 (UART)
//Serial1 is a hardware serial (UART) port

// Instantiate COMMAND PARSER object
typedef CommandParser<> MyCommandParser;
MyCommandParser parser;

const long SERIAL_BAUD_RATE = 115200; //Baud rate of the UART
//----
const int RX_PIN = 0; //Physical pins of the serial port
const int TX_PIN = 1;

const int RUN_CURRENT_PERCENT = 80; //Percentage current
const int HOLD_CURRENT_PERCENT = 10;
const int MICROSTEPS_PER_STEP = 8; //Microstepping (16 is more than enough)
const int CHIP_SELECT_PIN = 10; //Chip select pin ??? Is it for the TMC429 ???
const int CLOCK_FREQUENCY_MHZ = 32; //32 MHz - external source, generated by the Teensy on pin 9. See later in the code.
const int STEPS_PER_REV = 400; //Depends on the stepper motor, but typically either 200 (1.8 deg/step) or 400 (0.9 deg/step)
const int MICROSTEPS_PER_REV = STEPS_PER_REV * MICROSTEPS_PER_STEP; //Total steps needed to complete a full turn
const long ZERO_POSITION = 0; //Shortcut for the zero position
const long VELOCITY_MAX = 0.5 * MICROSTEPS_PER_REV; //Similarly to the acceleration, this is also empirical!
const int ACCELERATION_MAX = VELOCITY_MAX * 4; //Needs to be tested empirically because the mechanism (friction) can affect it
const long VELOCITY_MIN = 50; //Velocity cannot be 0, see datasheet. Below 50 steps/s the motor shuts down.

// New variables instead of the contants to dynamically change them if needed
long maxspeed_list[3] = {VELOCITY_MAX, VELOCITY_MAX, VELOCITY_MAX};
long maxaccel_list[3] = {ACCELERATION_MAX, ACCELERATION_MAX, ACCELERATION_MAX};

int microsteps_list[3] = {MICROSTEPS_PER_STEP, MICROSTEPS_PER_STEP, MICROSTEPS_PER_STEP};
int motorsteps_list[3] = {STEPS_PER_REV, STEPS_PER_REV, STEPS_PER_REV};

//Pins
const byte Analog_X_pin = A2; //x-axis readings - A2: 16
const byte Analog_Y_pin = A1; //y-axis readings - A1: 15
const byte Analog_Z_pin = A0; //r-axis readings - A0: 14

const byte forwardButton = 2; //Forward button - when pressed, it drives the selected axis in the positive direction
const byte backwardButton = 3; //Backward button - when pressed, it drives the selected axis in the negative direction
const byte abortButton = 4; //Aborts all movements
const byte redLEDpin = 5; //Red
const byte greenLEDpin = 6; //Green
const byte blueLEDpin = 7; //Blue
const byte clkPin = 9;//32 MHz CLK source for the TMC429 - Clock signal is generated by the Teensy. Set the CPU to 528 MHz!
//Limit switches are treated by the TMC429!

//Variables
int Analog_X = 0; //x-axis value
int Analog_Y = 0; //y-axis value
int Analog_Z = 0; //r-axis value

int Analog_X_AVG = 0; //x-axis value average
int Analog_Y_AVG = 0; //y-axis value average
int Analog_Z_AVG = 0; //r-axis value average

int joystickSpeedX = 0;
int joystickSpeedY = 0;
int joystickSpeedZ = 0;

float buttonSpeedinHz = 0.5;
int buttonSpeed = buttonSpeedinHz*MICROSTEPS_PER_STEP*STEPS_PER_REV;

byte previousGPIOData = 0; //Previous data from GPIO - helps to detect new settings

bool goForward = false; //forward motion enabled/disabled
bool goBackward = false; //backward motion enabled/disabled
bool abortMovement = false; //Abort button was pressed
bool limitSwitchWasHit = false; //If any of the 6 limit switches were hit (not during homing)
bool buttonModeXAxis = false; //Active axis in button mode is X
bool buttonModeYAxis = false; //Active axis in button mode is Y
bool buttonModeZAxis = false; //Active axis in button mode is Z
bool joystickMode = false; //Joystick mode enabled (3-axis joystick)
bool buttonMode = false; //Button mode enabled (forward and backward button)
bool UARTMode = true; //UART mode enabled (serial port control)
bool updateSettings = false; //Allows the code to update the settings (typically sends new config to the TMC chips)
bool stepperIsMoving = false; //Flag to indicate if a stepper motor is moving
bool limitSwitchActive = false; //If any of the limit switches become active, this status becomes true
//--------------------------------------------------------------------------------------------------------
//--------------------------------------------------------------------------------------------------------
bool advancedLimitStop = false;
bool limitSwitchesEnabled = false; //Globally enable/disable limit switch monitoring
bool switchSoftStop = false;
const int defaultMoveMode = 1;
//--------------------------------------------------------------------------------------------------------
//--------------------------------------------------------------------------------------------------------
bool debugMode = false;

int limitSwitchID = 0; //ID to see which switch got tripped
int modeSelection = 2; //0 = joystick, 1 = button, 2 = UART
int previousMode = 2; //Previous mode. Helps to keep track of change
unsigned long redLEDTimer = 0; //A variable that stores the elapsed time for the red LED
bool redLEDStatus = false; //Status flag of the red LED.

void setup()
{
  delay(1000);
  //SERIAL - USB
  Serial.begin(9600);
  Serial.println("TMC249 - TMC2209 - 3-axis motor driver board");
  //Serial COMANNDs setup
  // Movements and positions
  parser.registerCommand("gp", "u", &cmd_get_position); // Get Position
  parser.registerCommand("sp","ud", &cmd_set_position); // Sets the current position value to the defined number (useful for example resetting position)
  parser.registerCommand("mr", "ud", &cmd_go_relative); // Relative move in STEPs
  parser.registerCommand("ma", "ud", &cmd_go_absolute); // Absolute move in STEPs
  // ----- 2D MOVEMENTS ARE IMPLEMENTED FROM APPLICATION SOFTWARE ---------------------
  // parser.registerCommand("2r", "uudd", &cmd_move2d_relative); // Move in 2d - move in plane
  // parser.registerCommand("2a", "uudd", &cmd_move2d_absolute); // Move in 2d - move in plane

  // Switches
  parser.registerCommand("ea", "u", &cmd_enable_advanced_switchstop); // Enable the advanced switch monitoring
  parser.registerCommand("es", "u", &cmd_enable_switches); // Enable switches
  parser.registerCommand("ss", "uu", &cmd_enable_switches_per_motor); // Enable switches per motor
  parser.registerCommand("gs", "u", &cmd_get_switch_state); // Get the switch states per motor

  // Microsteps, move mode
  parser.registerCommand("sm", "uu", &cmd_set_microsteps); // Set microsteps for the given motor driver
  parser.registerCommand("mm", "uu", &cmd_set_move_mode); // Change move mode
  // parser.registerCommand("gm", "u", &cmd_get_microsteps); // Get the current microstep settings for the given motor

  // Velocities
  // Setters
  parser.registerCommand("sv","uu", &cmd_set_maxvelocity); // Sets the maximum velocity microsteps/revolution
  parser.registerCommand("tv","dd", &cmd_set_targetvelocity); // Sets the targetvelocity for velocitymode
  parser.registerCommand("sa","uu", &cmd_set_maxacceleration); // Sets the maximum accelaration that the rampgenerator will use to calculate velocity profile
  // Getters
  // parser.registerCommand("gv","u", &cmd_get_maxvelocity); // Get the maximum velocity microsteps/revolution
  // parser.registerCommand("ga","u", &cmd_get_maxacceleration); // Gets the maximum accelaration that the rampgenerator will use to calculate velocity profile
  // parser.registerCommand("gt","u", &cmd_get_targetvelocity); // Gets the targetvelocity for velocitymode
  parser.registerCommand("gv", "u", &cmd_get_velocities); // This returns all the velocities

  // Homing, movements check
  // parser.registerCommand("ho","u", &cmd_home_axis); // Homing for the given motor
  parser.registerCommand("mo","u", &cmd_is_moving); // Cheks if the given motor is moving base on velocity or targetposition

  // Auto tuning
  parser.registerCommand("at","u", &cmd_autotune); // Cheks if the given motor is moving base on velocity or targetposition

  //SERIAL for TMC2209
  Serial1.begin(SERIAL_BAUD_RATE);

  //Start the 32 MHz signal for the TMC429 (don't forget to compile the code with CPU = 528 MHz!)
  analogWriteFrequency(clkPin, CLOCK_FREQUENCY_MHZ*1000000); //Set pin and frequency
  analogWrite(clkPin, 128); //Start signal, 50% duty cycle

  //----------------------------------------------------------------------------
  Wire.begin(); 
  Wire.beginTransmission(0x20);
  Wire.write(0xFF);  //All ON - This is needed to be used with pull-up resistors
  Wire.endTransmission();
  //----------------------------------------------------------------------------
  //PINS
  pinMode(forwardButton, INPUT);
  pinMode(backwardButton, INPUT);
  pinMode(abortButton, INPUT);
  pinMode(redLEDpin, OUTPUT);
  pinMode(greenLEDpin, OUTPUT);
  pinMode(blueLEDpin, OUTPUT);
  //No lights
  analogWrite(redLEDpin, 0);
  analogWrite(greenLEDpin, 0);
  analogWrite(blueLEDpin, 0);
  //----------------------------------------------------------------------------
  InitialValues(); //averaging the values of the 3 analog pins (values from potmeters)
  //----------------------------------------------------------------------------

  //Motor drivers and main controller
  driver_list[0].setup(Serial1, SERIAL_BAUD_RATE, SERIAL_ADDRESS_0);
  driver_list[1].setup(Serial1, SERIAL_BAUD_RATE, SERIAL_ADDRESS_1);
  driver_list[2].setup(Serial1, SERIAL_BAUD_RATE, SERIAL_ADDRESS_2);
  stepper_controller.setup(CHIP_SELECT_PIN, CLOCK_FREQUENCY_MHZ);

  // Limit switch setup
  stepper_controller.setSwitchesActiveHigh(); //When switch goes HIGH, it sets an active reference switch signal.
  stepper_controller.enableRightSwitches();

  //DRIVER SETUP ------------------------------------------------------------
  //Stepper parameters
  //setting up some default values for maximum speed and maximum acceleration
  for (int i = 0; i < 3; i++) 
  {
    // Driver setup
    setupDriver(i, RUN_CURRENT_PERCENT, microsteps_list[i]);
    // Limit switch setup
    if (limitSwitchesEnabled == true)
    {
      enableSwitchesPerMotor(i, limitSwitchesEnabled);
      stepper_controller.setReferenceSwitchToLeft(i); //Homing switch is at the left (negative, motor) side
    }
    // Controller setup
    stepper_controller.setLimitsInHz(i, VELOCITY_MIN, VELOCITY_MAX, ACCELERATION_MAX);
    stepper_controller.setVelocityMode(i);//Before overwriting X_ACTUAL choose velocity_mode or hold_mode.
    stepper_controller.setTargetVelocity(i, 0); //...the parameter V_MAX should be set to zero...
    stepper_controller.setActualPosition(i, ZERO_POSITION);
    stepper_controller.setTargetPosition(i, ZERO_POSITION);
    stepper_controller.setRampMode(i); // Ramp with linear stop
    driver_list[i].enable();
    driver_list[i].moveUsingStepDirInterface();
    delay(250);

  }

  enableAllSwitches(limitSwitchesEnabled);

  int testmotor = 0;
  Serial.print("PWM Scale Auto, Offset Auto, Gradient Auto = ");
  Serial.print(driver_list[testmotor].getPwmScaleAuto()); Serial.print(" "); Serial.print(driver_list[testmotor].getPwmOffsetAuto()); Serial.print(" "); Serial.println(driver_list[testmotor].getPwmGradientAuto());


}

void loop()
{
  // serialCommandReceiver(); //Polls the serial port for incoming instructions/commands
  serialListener();
  ReadAnalog(); //Read the joystick
  checkButtons(); //Poll the buttons
  driveMotorWithButtons(); //Send commands to the motor when it is actual
  readGPIOExpander(); //Read which axis and which control mode is enabled
  sendNewSettings(); //When the user switches to another mode, this function takes care of it. 
  monitorLimitSwitches(); //Keeps monitoring the switches and parks the motors after a limit switch was hit while moving
  checkMotorMovement(); //Check if the motor is moving so we can keep the LEDs properly updated
  //----------------------------------------------------------------------------------------------------------------------
  //This function runs last so everything has the chance to update the statuses
  updateStatusLED();
}

void setupDriver(int motorNumber, int current_percent, int microsteps)
{
  driver_list[motorNumber].setRunCurrent(current_percent);
  driver_list[motorNumber].setHoldCurrent(HOLD_CURRENT_PERCENT);
  driver_list[motorNumber].setHoldDelay(10);
  // driver_list[motorNumber].useInternalSenseResistors();
  driver_list[motorNumber].enableAutomaticCurrentScaling();
  driver_list[motorNumber].enableAutomaticGradientAdaptation();
  driver_list[motorNumber].enableCoolStep();
  driver_list[motorNumber].setMicrostepsPerStep(microsteps);
  driver_list[motorNumber].enableStealthChop(); //This MUST be enabled for correct motor behaviour
}

void AutoTuneDriver(int motorNumber)
{
  TMC2209::Settings settings = driver_list[motorNumber].getSettings();
  if(settings.software_enabled == 0){driver_list[motorNumber].enable();};

  // Serial.print("PWM Scale Auto, Offset Auto, Gradient Auto = ");
  // Serial.print(driver_list[motorNumber].getPwmScaleAuto()); Serial.print(" "); Serial.print(driver_list[motorNumber].getPwmOffsetAuto()); Serial.print(" "); Serial.println(driver_list[motorNumber].getPwmGradientAuto());

  // driver_list[motorNumber].enableAutomaticCurrentScaling();
  // Move a bit to switch to I_RUN
  goRelative(motorNumber, microsteps_list[motorNumber]);
  while (stepper_controller.getActualVelocity(motorNumber) != 0 || stepper_controller.atTargetPosition(motorNumber) == false){
      delay(10);
  }
  // Wait 300 ms
  delay(300);

  // Serial.print("PWM Scale Auto, Offset Auto, Gradient Auto = ");
  // Serial.print(driver_list[motorNumber].getPwmScaleAuto()); Serial.print(" "); Serial.print(driver_list[motorNumber].getPwmOffsetAuto()); Serial.print(" "); Serial.println(driver_list[motorNumber].getPwmGradientAuto());
  
  // Move a full spin and back
  int oldaccel = stepper_controller.getAccelerationMaxInHzPerS(motorNumber);
  int oldspeed = stepper_controller.getVelocityMaxInHz(motorNumber);
  int newspeed = 1*MICROSTEPS_PER_REV;
  int newaccel = 3*newspeed;
  // Set a bit higher speed
  changeMaxVelocities(motorNumber, newspeed, newaccel);
  int steps = microsteps_list[motorNumber]*motorsteps_list[motorNumber];
  goRelative(motorNumber,2*steps);
  while (stepper_controller.getActualVelocity(motorNumber) != 0 || stepper_controller.atTargetPosition(motorNumber) == false){
      delay(100);
  }
  // Serial.print("PWM Scale Auto, Offset Auto, Gradient Auto = ");
  // Serial.print(driver_list[motorNumber].getPwmScaleAuto()); Serial.print(" "); Serial.print(driver_list[motorNumber].getPwmOffsetAuto()); Serial.print(" "); Serial.println(driver_list[motorNumber].getPwmGradientAuto());
  
  delay(250);

  // Go back to the origin
  goRelative(motorNumber,-2*steps);
  while (stepper_controller.getActualVelocity(motorNumber) != 0 || stepper_controller.atTargetPosition(motorNumber) == false){
      delay(100);
  }

  driver_list[motorNumber].setHoldCurrent(0);

  changeMaxVelocities(motorNumber, oldspeed, oldaccel);
}

void changeMicroSteps(int motorNumber, int microsteps)
{
  int old_microsteps = driver_list[motorNumber].getMicrostepsPerStep();
  // Set up the new settings
  driver_list[motorNumber].setMicrostepsPerStep(microsteps);
  microsteps_list[motorNumber] = driver_list[motorNumber].getMicrostepsPerStep();
  // Update the acceleration values
  maxaccel_list[motorNumber] = maxaccel_list[motorNumber]/old_microsteps*microsteps_list[motorNumber];
  maxspeed_list[motorNumber] = maxspeed_list[motorNumber]/old_microsteps*microsteps_list[motorNumber];
  stepper_controller.setLimitsInHz(motorNumber, VELOCITY_MIN, maxspeed_list[motorNumber], maxaccel_list[motorNumber]);
}

void changeMaxVelocities(int motorNumber, int maxspeed, int maxaccel)
{
  maxspeed_list[motorNumber] = maxspeed;
  maxaccel_list[motorNumber] = maxaccel;
  stepper_controller.setLimitsInHz(motorNumber, VELOCITY_MIN, maxspeed, maxaccel);
}

void checkMotorMovement() // for the LEDs
{
    for (int i = 0; i < 3; i++)
    {
        //Check each stepper motor if they are moving or not.
        if (stepper_controller.getActualVelocity(i) != 0)
        {
          stepperIsMoving = true;
          //If at least one motor is moving, we can immediately jump out of this loop
          break;
        } 
        else
        {
            stepperIsMoving = false;
        }
    }
}

bool isMotorMoving(int motorNumber)
{
  bool moving;
  if (stepper_controller.getActualVelocity(motorNumber) != 0)
  {
    moving = true;
  } 
  else
  {
    moving = false;
  }
  return moving;
}

void updateStatusLED()
{
    //This function follows the status flags and triggers the correspoding LED
    //Abort button is pressed - Blinking Red
    if (abortMovement == true)
    {
        //Serial.println("Red LED, blinking");
        if (millis() - redLEDTimer >= 1000) //Blink Red LED every 1 s
        {
            if (redLEDStatus == false)
            {
                analogWrite(redLEDpin, 255);
                analogWrite(greenLEDpin, 0);
                analogWrite(blueLEDpin, 0);
                redLEDStatus = true;
            }
            else
            {
                analogWrite(redLEDpin, 0); //(no need to update all three because the previous if() did it)
                redLEDStatus = false;
            }
            redLEDTimer = millis();
        }
    }
    
    else if (stepper_controller.communicating() == false)
    {       
        analogWrite(redLEDpin, 255);
        analogWrite(greenLEDpin, 165);
        analogWrite(blueLEDpin, 0);
    }    
    else if(limitSwitchActive == true) //Turn on red LED when any of the limit switches are active
    {
        analogWrite(redLEDpin, 255);
        analogWrite(greenLEDpin, 0);
        analogWrite(blueLEDpin, 0);
    }
    else if (stepperIsMoving == true) //Turn on green LED when any of the motors are moving
    {
        analogWrite(redLEDpin, 0);
        analogWrite(greenLEDpin, 255);
        analogWrite(blueLEDpin, 0);
    }
    else //Standby - Turn on blue LED
    {
        analogWrite(redLEDpin, 0);
        analogWrite(greenLEDpin, 0);  
        analogWrite(blueLEDpin, 255);
    }
}

void readGPIOExpander()
{
    //This function reads the GPIO expander
    //0-1-2 pins: X-Y-Z selector - Always only 1 axis is active
    //3-4-5 pins: Joystick, button, UART selector - Always only 1 mode is active
    byte gpioData = 0; //8-bit reading from the expander
    Wire.requestFrom(0x20, 1); //get 1 byte (8bit) from 0x20 address
    if (Wire.available()) 
    {
        gpioData = Wire.read();
    }
    /*
    //This little code prints back the bits that were set for the GPIO module
    Serial.print("GPIO: ");
    for (int i = 7; i >= 0; i--)
    {
        Serial.print((gpioData >> i) & 1); 
        //Print/shift the register bits until the whole byte is printed
    }
    Serial.println();    
    //------------------------------------------------------------------------------
    */

    if (previousGPIOData != gpioData)
    {
        previousGPIOData = gpioData; //Update to the most recent reading
        updateSettings = true; //Let the rest of the code know about the new values
        limitSwitchActive = false; //Reset limit switch status here
        if (debugMode == true){Serial.println("Updated switch statuses!");}

        //Blink the blue LED to indicate the received change
        analogWrite(redLEDpin, 0);
        analogWrite(blueLEDpin, 0);
        analogWrite(greenLEDpin, 0);

        for (int i = 0; i < 3; i++)
        {
            analogWrite(blueLEDpin, 0);
            delay(50);
            analogWrite(blueLEDpin, 255);
            delay(50);
        } //(100+100)*5 ms = 1000 ms delay
    }

    //Ugly implementation of reading the individual bits

    if (bitRead(gpioData, 0) == 1) //If pin 0 is high
    {
        buttonModeXAxis = false;
    }
    else //Pin 0 is low -> pulled to GND via the switch, so it is ACTIVE!
    {
        buttonModeXAxis = true;
    }

    if (bitRead(gpioData, 1) == 1) //If pin 1 is high
    {
        buttonModeYAxis = false;
    }
    else
    {
        buttonModeYAxis = true;
    }

    if (bitRead(gpioData, 2) == 1) //If pin 2 is high
    {
        buttonModeZAxis = false;
    }
    else
    {
        buttonModeZAxis = true;
    }
    //----------------------------------------------------------------
    if (bitRead(gpioData, 3) == 1) //If pin 3 is high
    {        
        joystickMode = false;
    }
    else
    {
        joystickMode = true;
    }

    if (bitRead(gpioData, 4) == 1) //If pin 4 is high
    {
        buttonMode = false;
    }
    else
    {
        buttonMode = true;
    }

    if (bitRead(gpioData, 5) == 1) //If pin 5 is high
    {
        UARTMode = false;
    }
    else
    {
        UARTMode = true;
    }
    //--------------------------------------------------------------------
}

void ReadAnalog()
{
    if (joystickMode == true) //Only listen to the joystick when the joystick mode is enabled!
    {
        //Reading the 3 potentiometers in the joystick: x, y and r.

        for (int i = 0; i < 10; i++) //Sum 10 readings
        {
            Analog_X += analogRead(Analog_X_pin);
            delayMicroseconds(10);
            Analog_Y += analogRead(Analog_Y_pin);
            delayMicroseconds(10);
            Analog_Z += analogRead(Analog_Z_pin);
            delayMicroseconds(10);
        } //300 us delay + 30x ADC conversion time which is just a few us total

        //Divide the sum of 10 readings by 10
        Analog_X /= 10.0;
        Analog_Y /= 10.0;
        Analog_Z /= 10.0;
                

        //if the value is 20 units away from the average (midpoint), we allow the update of the speed
        //This is a sort of a filter for the inaccuracy of the reading
        if (abs(Analog_X - Analog_X_AVG) > 20)
        {
            joystickSpeedX = (int)(3.8 * (Analog_X - Analog_X_AVG));
            if (debugMode == true){
                Serial.print("joystick-X:"); Serial.println(joystickSpeedX);
                }
            //speed = x
            stepper_controller.setTargetVelocity(0, joystickSpeedX);      
            //The 12 multiplier depends on the mechanism used with the motor. Test it with your system!
            stepperIsMoving = true;                        
        }
        else if (abs(Analog_Y - Analog_Y_AVG) > 20)
        {
            joystickSpeedY = (int)(3.8 * (Analog_Y - Analog_Y_AVG));
            if (debugMode == true){
                Serial.print("joystick-Y:"); Serial.println(joystickSpeedY);
            }

            // speed = y
            stepper_controller.setTargetVelocity(1, joystickSpeedY);
            //The 12 multiplier depends on the mechanism used with the motor. Test it with your system!
            stepperIsMoving = true;
        }
        else if (abs(Analog_Z - Analog_Z_AVG) > 30) //Z works well with these settings
        {
            joystickSpeedZ = (int)(3.8 * (Analog_Z - Analog_Z_AVG));
            if (debugMode == true){
                Serial.print("joystick-Z:"); Serial.println(joystickSpeedZ);
            }

            //speed = z
            stepper_controller.setTargetVelocity(2, joystickSpeedZ);
            //The 5 multiplier depends on the mechanism used with the motor. Test it with your system!
           stepperIsMoving = true;
        }
        else
        {
            if (debugMode == true){
                Serial.println("joystick-standstill");
            }

            //speed = 0 for all motors
            stepper_controller.setTargetVelocity(0, 0); 
            stepper_controller.setTargetVelocity(1, 0);
            stepper_controller.setTargetVelocity(2, 0);
            stepperIsMoving = false;
        }      
        //Reset analog values - necessary, otherwise the sum will be messed up!
        Analog_X = 0;
        Analog_Y = 0;
        Analog_Z = 0;
    }
}

void InitialValues()
{
  //Set the temp values to zero before averaging
  float tempX = 0;
  float tempY = 0;
  float tempZ = 0;
  //----------------------------------------------------------------------------
  //read the analog 50x, then calculate an average.
  //they will be the reference values
  for (int i = 0; i < 50; i++)
  {
    tempX += analogRead(Analog_X_pin);
    delay(10); //allowing a little time between two readings
    tempY += analogRead(Analog_Y_pin);
    delay(10);
    tempZ += analogRead(Analog_Z_pin);
    delay(10);
  }
  //(30 ms + readout(?))*50 times approx 2 seconds
  //----------------------------------------------------------------------------
  Analog_X_AVG =(int)( tempX / 50.0);
  Analog_Y_AVG =(int)(tempY / 50.0);
  Analog_Z_AVG =(int)(tempZ / 50.0); //The float division is casted into int.
  //----------------------------------------------------------------------------
  if (debugMode == true){
    Serial.print("AVG_X: ");
    Serial.println(Analog_X_AVG);
    Serial.print("AVG_Y: ");
    Serial.println(Analog_Y_AVG);
    Serial.print("AVG_Z: ");
    Serial.println(Analog_Z_AVG);
    Serial.println("Calibration is finished!");
  }
}

void setMoveMode(int motornum, int modecode)
{
    switch (modecode){
    case 0:{
      int pos = stepper_controller.getActualPosition(motornum);
      stepper_controller.setTargetPosition(motornum, pos);
      stepper_controller.setSoftMode(motornum); // exponential acceleration at start and finish
      break;}
    case 1:{
      int pos = stepper_controller.getActualPosition(motornum);
      stepper_controller.setTargetPosition(motornum, pos);
      stepper_controller.setRampMode(motornum); // linear acceleration (speed change)
      break;}
    case 2:{
      stepper_controller.setVelocityMode(motornum); // constant target velocity is maintained
      break;}
    case 3:{
      stepper_controller.setHoldMode(motornum); // brutally goes wherever you want it - HULK MODE
      break;}
  }
}

// STEP UNIT MOVEMENTS ------------------------------------------------------------------------------------------------------------------------------------------------
// RELATIVE -------------------------------------------------------------------------
void goRelative(int motorNumber, long Steps) //Moves the stage by Steps STEP along the X axis relative to the current position
{
  long targetSteps = 0;
  //Get the current position of the X motor in STEPS
  long start_position = stepper_controller.getActualPosition(motorNumber);
  //Add relative movement steps to the current position to get the new target location
  targetSteps = start_position + Steps;
  //send the command to the TMC429
  stepper_controller.setTargetPosition(motorNumber, targetSteps);
}
// ABSOLUTE -------------------------------------------------------------------------
void goAbsolute(int motorNumber, long Steps) //Moves the stage by Steps STEP along the X axis relative to the current position
{
  stepper_controller.setTargetPosition(motorNumber, Steps); //Move X (0) to the recently determined target
}

void go2dRelative(int motorNumber1, int motorNumber2, long Position1, long Position2) //Brings the stage to a predetermined x and y simultaneously position in mm
{
    // long start_position1 = stepper_controller.getActualPosition(motorNumber1);
    // long start_position2 = stepper_controller.getActualPosition(motorNumber2);

    // Get the original velocity setting for the two axes
    long oldMotorSpeed1 = stepper_controller.getVelocityMaxInHz(motorNumber1);
    long oldMotorSpeed2 = stepper_controller.getVelocityMaxInHz(motorNumber2);
    long oldAccel1 = stepper_controller.getAccelerationMaxInHzPerS(motorNumber1);
    long oldAccel2 = stepper_controller.getAccelerationMaxInHzPerS(motorNumber2);

    // Calculate speeds for the different directions
    float angle = atan2f((float)Position2, (float)Position1);
    float v = (float)(oldMotorSpeed1+oldMotorSpeed2)/2;
    float a = (float)(oldAccel1+oldAccel2)/2;
    // Serial.print("Original avg speed:"); Serial.println((long)v);
    // Serial.print("Original avg accel:"); Serial.println((long)a);
    long speed1 = (long)abs(v*cosf(angle));
    long speed2 = (long)abs(v*sinf(angle));
    int accel1 = (int)abs(a*cosf(angle));
    int accel2 = (int)abs(a*sinf(angle));
    // Serial.print("New Speed 1:"); Serial.println(speed1);
    // Serial.print("New Speed 2:"); Serial.println(speed2);
    // Serial.print("New Accel 1:"); Serial.println(accel1);
    // Serial.print("New Accel 2:"); Serial.println(accel2);

    stepper_controller.setLimitsInHz(motorNumber1, VELOCITY_MIN, speed1, accel1);
    delayMicroseconds(50);
    stepper_controller.setLimitsInHz(motorNumber2, VELOCITY_MIN, speed2, accel2);
    delayMicroseconds(50);

    goRelative(motorNumber1, Position1);
    delayMicroseconds(10); //a short delay, but probably, it is unnecessary
    goRelative(motorNumber2, Position2);
    delayMicroseconds(10);

    while (stepper_controller.getActualVelocity(motorNumber1) != 0 || stepper_controller.getActualVelocity(motorNumber2) != 0 || stepper_controller.atTargetPosition(motorNumber1) == false || stepper_controller.atTargetPosition(motorNumber2) == false){
      delay(10);
      // Serial.println("Moving?");
    }
    // Apply the old speed settings again
    stepper_controller.setLimitsInHz(motorNumber1, VELOCITY_MIN, oldMotorSpeed1, oldAccel1);
    delayMicroseconds(50);
    stepper_controller.setLimitsInHz(motorNumber2, VELOCITY_MIN, oldMotorSpeed2, oldAccel2);
}

void go2dAbsolute(int motorNumber1, int motorNumber2, long Position1, long Position2) //Brings the stage to a predetermined x and y simultaneously position in mm
{   // Get the starting coordinates
    long start_position1 = stepper_controller.getActualPosition(motorNumber1);
    long start_position2 = stepper_controller.getActualPosition(motorNumber2);
    // Calculate the relative movements
    long delta1 = Position1 - start_position1;
    long delta2 = Position2 - start_position2;
    // Get the original velocity setting for the two axes
    long oldMotorSpeed1 = stepper_controller.getVelocityMaxInHz(motorNumber1);
    long oldMotorSpeed2 = stepper_controller.getVelocityMaxInHz(motorNumber2);
    long oldAccel1 = stepper_controller.getAccelerationMaxInHzPerS(motorNumber1);
    long oldAccel2 = stepper_controller.getAccelerationMaxInHzPerS(motorNumber2);
    // Calculate speeds for the different directions
    float angle = atan2f((float)delta2, (float)delta1);
    float v = (float)(oldMotorSpeed1+oldMotorSpeed2)/2;
    float a = (float)(oldAccel1+oldAccel2)/2;
    long speed1 = (long)abs(v*cosf(angle));
    long speed2 = (long)abs(v*sinf(angle));
    int accel1 = (int)abs(a*cosf(angle));
    int accel2 = (int)abs(a*sinf(angle));

    stepper_controller.setLimitsInHz(motorNumber1, VELOCITY_MIN, speed1, accel1);
    delayMicroseconds(50);
    stepper_controller.setLimitsInHz(motorNumber2, VELOCITY_MIN, speed2, accel2);
    delayMicroseconds(50);

    goAbsolute(motorNumber1, Position1);
    delayMicroseconds(10); //a brief delay, but probably, it is unnecessary
    goAbsolute(motorNumber2, Position2);
    delayMicroseconds(10);

    while (stepper_controller.getActualVelocity(motorNumber1) != 0 || stepper_controller.getActualVelocity(motorNumber2) != 0 || stepper_controller.atTargetPosition(motorNumber1) == false || stepper_controller.atTargetPosition(motorNumber2) == false){
      delay(10);
      // Serial.println("Moving?");
    }
    // Apply the old speed settings again
    stepper_controller.setLimitsInHz(motorNumber1, VELOCITY_MIN, oldMotorSpeed1, oldAccel1);
    delayMicroseconds(50);
    stepper_controller.setLimitsInHz(motorNumber2, VELOCITY_MIN, oldMotorSpeed2, oldAccel2);
}
// --------------------------------------------------------------------------------------------------------------------------------------------------------------------

void sendNewSettings()
{
    //Check the status of the mode selector switch 
    if (updateSettings == true)
    {
        updateSettings = false; //set to false, so this function only performed once
        abortMovement = false; //Reset abort status after changing a mode - abort can be reset by switching mode or axis
        limitSwitchWasHit = false; //Reset the limit switch hit status flag

        if (joystickMode == true)
        {
            //Print a message and switch to velocity mode
            if (debugMode == true){Serial.println("Joystick mode enabled");}
            stepper_controller.setVelocityMode(0);
            stepper_controller.setVelocityMode(1);
            stepper_controller.setVelocityMode(2);
            //-----
            //Make the other two modes false/disabled
            buttonMode = false;
            UARTMode = false;
        }
        //-----

        if (buttonMode == true)
        {
            //Print a message and switch to velocity mode
            if (debugMode == true){Serial.println("Button mode enabled");}
            stepper_controller.setVelocityMode(0);
            stepper_controller.setVelocityMode(1);
            stepper_controller.setVelocityMode(2);
            //-----
            //Make the other two modes false/disabled
            joystickMode = false;
            UARTMode = false;
        }
        //-----

        if (UARTMode == true)
        {
            //Print a message and switch to soft (or ramp) mode
            if (debugMode == true){Serial.println("UART mode enabled");}

            //When switching to UART mode, the target should be set as the actual position (Section 8.1.1)
            long tempPos_x = stepper_controller.getActualPosition(0);
            long tempPos_y = stepper_controller.getActualPosition(1);
            long tempPos_z = stepper_controller.getActualPosition(2);

            stepper_controller.setTargetPosition(0, tempPos_x);
            stepper_controller.setTargetPosition(1, tempPos_y);
            stepper_controller.setTargetPosition(2, tempPos_z);

            stepper_controller.setRampMode(0); 
            stepper_controller.setRampMode(1);
            stepper_controller.setRampMode(2);
            //-----
            //Make the other two modes false/disabled
            buttonMode = false;
            joystickMode = false;
        }
    }
    
}

void motorHoming(int motorNumber) //Motor numbers: x = 0, y = 1, z = 2.
{
        //First of all, make sure that the system is in soft mode!
        if (joystickMode == true || buttonMode == true)
        {
            stepper_controller.setSoftMode(motorNumber);
            //Change the motor to soft mode if it was in velocity mode
        }
        //----
        //Set the motor to a slower speed temporarily, so it won't crash during homing. Pay attention, this value depends on the mechanism!!!
        changeMicroSteps(motorNumber, MICROSTEPS_PER_STEP);
        stepper_controller.setLimitsInHz(motorNumber, VELOCITY_MIN, MICROSTEPS_PER_REV, ACCELERATION_MAX);
        // 

        /* HOMING PROCEDURE
        * 1; Dummy write to X_LATCHED
        * 2; Send the motor towards the negative direction
        * 3; When reaching X2, the position is latched
        * 4; Set the DX_REF_TOLERANCE to allow movement within the x1-x2 range and move to a position < x1 if desired
        * 5; Initialize X_LATCHED again, and latch the position x1 by a motion towards the positive direction
        * 6; When x1 and x2 are determined, ref becomes (x1+x2)/2.
        * 7; Move to X_TARGET = xref and set X_TARGET := 0 and X_ACTUAL := 0;
        */

        //stepper_controller.writeRegister(0, 0b1101, 1000);//x (0) motor, 1101 - DX_REF_TOLERANCE register, 1000 (?) steps. 
        //I am not sure if the above line is correct. 
        //---------------------------------------------------------------------------------------------------------------------------------

        // 1;
        //8.1.15: X_latched. This read-only register stores the actual position upon a change of the reference switch state. 
        stepper_controller.startLatchPositionWaiting(motorNumber); //Waits for the latch position (homing position where the switch were triggered)
        //Notice that if the motor is within x1-x2, it has to move out first because the switch is active.
        //We assume that the motor is not touching the switch right now

        //2;Motor is between xmax and x2 and latch is initialized. We need to go towards -1*xmax (negative direction).

        if (debugMode == true){Serial.println("Homing started.");} //Indicate that the homing motion is ongoing    
        stepper_controller.setTargetPosition(motorNumber, -5000000); //Send the motor backwards towards the left switch (REF1)
        //We need to send a ridiculuosly large target position so we can be sure that the motor will eventually reach the switch
        //When the motor is used with a lead screw, enter the equivalent number of steps for the length of the screw "plus a little"

        if (debugMode == true){Serial.print("Latch status: "); //Check the latch status if it is correct
        Serial.println(stepper_controller.latchPositionWaiting(motorNumber));} //Print the latch status for the X (0) motor

        while (stepper_controller.latchPositionWaiting(motorNumber) == 1) //lp bit is set to 0 when the position is latched by the switch
        {
            //Wait here until the switch is latched
            //The motor is running in the meantime while the condition is true
        }//X2 reached after exiting the while()


        if (debugMode == true){Serial.print("Latch status-x2: "); //Print the latch status for the X (0) motor after reaching the switch
        Serial.println(stepper_controller.latchPositionWaiting(motorNumber));}

        long x2Pos = stepper_controller.getLatchPosition(motorNumber); //Save the current latch position for later calculations
        if (debugMode == true){Serial.print("Latched-x2: "); Serial.println(x2Pos);} //Print the latch position for the x2 position

        //Set a DX_REF_TOLERANCE to allow motion within x1-x2 range.
        stepper_controller.writeRegister(motorNumber, 0b1101, 20000);//x (0) motor, 1101 - DX_REF_TOLERANCE register, 10000 steps. 
        //I am not sure about the number of steps, this could be determined by experiment, but 10k seems fine
        if (debugMode == true){Serial.println("DX tolerance done");} //Indicate the status

        //Initialize X_Latched again to latch the position x1 by a motion to a target position below x1 (between x1 and dx1)
        stepper_controller.startLatchPositionWaiting(motorNumber); //Re-initialize latching
        if (debugMode == true){Serial.println("Latch reinitalized");}; //Print status
        stepper_controller.setTargetPosition(motorNumber, (x2Pos + 6000)); //Send the motor backwards towards the left switch (REF1) by a little
        //The stepper goes towards an even more negative position, but short enough so that the switch status is still pressed
        //Again, the number of steps is experimental!

        //Next, we wait until the motor reaches the target position
        while (stepper_controller.atTargetPosition(motorNumber) == 0)
        {
            //Wait here until the target is reached
            //The motor is running in the meantime while the condition is true
        }

        if (debugMode == true){Serial.print("Latch status-x1: "); //Print the latch status. It should be still ready to be latched (unchanged, == 1)
        Serial.println(stepper_controller.latchPositionWaiting(motorNumber));}

        long x1Pos = stepper_controller.getLatchPosition(motorNumber); //Save the new latch position and print it
        if (debugMode == true){Serial.print("Latched-x1: "); Serial.println(x1Pos);}

        long refPos = (long)((x2Pos + x1Pos) / 2); //Calculate the midpoint between x2 and x1. This is the reference (home) position
        //Keep in mind that the motor here is still stopped and the limit switch is pressed.

        if (debugMode == true){Serial.print("RefPos: "); Serial.println(refPos);} //Print the reference position just for checking

        stepper_controller.setTargetPosition(motorNumber, refPos); //Update the target position as the reference position - move the motor to the midpoint

        if (debugMode == true){Serial.println("Moving towards RefPos");}
        while (stepper_controller.atTargetPosition(motorNumber) == 0)
        {
            //Wait here until we reach the target position (xref)            
        }
        if (debugMode == true){Serial.println("Arrived at RefPos");}

        stepper_controller.setVelocityMode(motorNumber);//Before overwriting X_ACTUAL choose velocity_mode or hold_mode.
        stepper_controller.setTargetVelocity(motorNumber, 0); //...the parameter V_MAX should be set to zero...
        stepper_controller.setActualPosition(motorNumber, 0); //set X (0) position to 0 at the reference position
        stepper_controller.setTargetPosition(motorNumber, 0); //Target has to be set to 0, so the latest value (-xmax) is updated.

        if (debugMode == true){Serial.print("Home: "); Serial.println(stepper_controller.getActualPosition(motorNumber)); //Print the new home position (it should be 0)
        Serial.println("Homing completed");} //Print status message.

        //First of all, make sure that the system is in soft mode!
        if (joystickMode == true || buttonMode == true)
        {
            //Latest mode was velocity mode, so we leave it as-is
        }
        else
        {
            stepper_controller.setRampMode(motorNumber); //Set back ramp mode (mode was UART)
        }

        //Reset initial speed settings
        stepper_controller.setLimitsInHz(motorNumber, VELOCITY_MIN, maxspeed_list[motorNumber], maxaccel_list[motorNumber]);    
}

void enableAllSwitches(bool state)
{
  for (int motorNumber = 0; motorNumber < 3; motorNumber++)
  {
    enableSwitchesPerMotor(motorNumber, state);
  }
  delay(100);
  limitSwitchesEnabled = state;
}

void enableSwitchesPerMotor(int motorNumber, bool state){
  if (state == true){
    //The limit switch module I use is HIGH by default. When pressed, it goes LOW.
    stepper_controller.enableLeftSwitchStop(motorNumber); //Motor stops when the speed is negative and REF1 is active
    stepper_controller.enableRightSwitchStop(motorNumber); // Motor stops when the speed is positive and REFR1 is active
    if (switchSoftStop == true){
      stepper_controller.enableSwitchSoftStop(motorNumber);
    }
    else {
      stepper_controller.disableSwitchSoftStop(motorNumber);
    } // Motor stops hard when hitting the switch
  }
  else if (state == false){
    // stepper_controller.disableRightSwitches(); // DO WE NEED THIS??????
    stepper_controller.disableLeftSwitchStop(motorNumber); //Motor stops when the speed is negative and REF1 is active
    stepper_controller.disableRightSwitchStop(motorNumber); // Motor stops when the speed is positive and REFR1 is active
  }
}

void monitorLimitSwitches()
{
    if (limitSwitchesEnabled == true)//Only monitor limit switches if the user enabled it!
    {
        //This function monitors the limit switches while the motor is driven towards its target
        //Notice! All switches must be connected for proper behaviour!
        bool R_limitSwitchStatus = false; //Right limit switch, away from motor/home (positive direction)
        bool L_limitSwitchStatus = false; //Left limit switch, towards motor/home (negative direction)
        // int motorNumber = 0;

        //Loop for R
        for (int motorNumber = 0; motorNumber < 3; motorNumber++)
        {
            R_limitSwitchStatus = stepper_controller.rightSwitchActive(motorNumber);
            L_limitSwitchStatus = stepper_controller.leftSwitchActive(motorNumber);

            if (R_limitSwitchStatus == true)
            {
                //If any of the switches were activated, we stop 
                //Assumption: no simultaneous motor motion!
                limitSwitchWasHit = true; //Set the status to true
                limitSwitchActive = true;
                // Serial.println("Right limit switch " + String(motorNumber) + " was activated");

                updateStatusLED();//Indicate status with red LED

                if (advancedLimitStop == true){
                  long tempposition = stepper_controller.getActualPosition(motorNumber);
                  //Motor is stopped by the controller here as long as the switch is pressed
                  stepper_controller.setTargetPosition(motorNumber, tempposition);

                  //Check if this will interfere with homing!!!
                  //Switch to velocity mode, so the motor can be controlled by speed
                  stepper_controller.setVelocityMode(motorNumber); //Select the motor that triggered the switch
                  stepper_controller.setTargetVelocity(motorNumber, -500); //Send it backwards with an arbitrary speed

                  while (stepper_controller.rightSwitchActive(motorNumber) == true) //while the switch is active
                  {
                      //This while() runs while the switch is pressed
                  }

                  stepper_controller.setTargetVelocity(motorNumber, 0); //Stop the motor by setting its speed to 0

                  //These two lines make sure that the motor is stopped and it does not try to go towards the previously set target
                  tempposition = stepper_controller.getActualPosition(motorNumber);
                  stepper_controller.setTargetPosition(motorNumber, tempposition);

                  setMoveMode(motorNumber, defaultMoveMode);
                  break; //Exit the for loop so the loop can inspect the other switches as well
                }
            }

            if (L_limitSwitchStatus == true)
            {
                //If any of the switches were activated, we stop 
                //Assumption: no simultaneous motor motion!
                limitSwitchWasHit = true; //Set the status to true
                limitSwitchActive = true;
                // Serial.println("Left limit switch " + String(motorNumber) + " was activated");

                updateStatusLED();

                if (advancedLimitStop == true){
                  long tempposition = stepper_controller.getActualPosition(motorNumber);
                  //Motor is stopped by the controller here as long as the switch is pressed
                  stepper_controller.setTargetPosition(motorNumber, tempposition);

                  //Check if this will interfere with homing!!!

                  //Switch to velocity mode, so the motor can be controlled by speed
                  stepper_controller.setVelocityMode(motorNumber); //Select the motor that triggered the switch
                  stepper_controller.setTargetVelocity(motorNumber, 500); //Send it forwards with an arbitrary speed

                  while (stepper_controller.leftSwitchActive(motorNumber) == true) //while the switch is active
                  {
                      //This while() runs while the switch is pressed
                  }

                  stepper_controller.setTargetVelocity(motorNumber, 0); //Stop the motor by setting its speed to 0

                  //These two lines make sure that the motor is stopped and it does not try to go towards the previously set target
                  tempposition = stepper_controller.getActualPosition(motorNumber);
                  stepper_controller.setTargetPosition(motorNumber, tempposition);

                  setMoveMode(motorNumber, defaultMoveMode);
                  break; //Exit the for loop so the loop can inspect the other switches as well
                }
            }
            if (L_limitSwitchStatus == false && R_limitSwitchStatus == false) {
                limitSwitchActive = false;
              // limitSwitchWasHit = false;
            }
        }
    }

}

void checkButtons()
{
    if (buttonMode == true) //Only listen to these 2 buttons in button mode
    {
        if (digitalRead(forwardButton) == 0) //Forward button is pressed
        {
            goForward = true;
            stepperIsMoving = true;
        }
        else if(digitalRead(backwardButton) == 0) //Backward button is pressed
        {
            goBackward = true;
            stepperIsMoving = true;
        }
        else //Forward or backward button is released
        {
            goBackward = false;
            goForward = false;
            stepperIsMoving = false;
        }
    }

   //----
   //We always listen to the abort button!    
   if(digitalRead(abortButton) == 0) //Abort button is pressed, this should be a 2-state (clicking) button, not a pushbutton!
   {
       Serial.println("Abort button was pressed!");

       if (stepperIsMoving == true) //Only abort movement when there's any
       {
           if (debugMode == true){Serial.println("---STOP---");}
           abortMovement = true;
           stepperIsMoving = false;
       }
   }
   else //Abort button is released
   {
      abortMovement = false;
   }  
   
}

void driveMotorWithButtons()
{
    //--------------------------------------------------------------------------------------------------------------------
    //Driving the motor forwards
    //Abort function is not used here since the motors immediately stop when the button is released
    //--------------------------------------------------------------------------------------------------------------------
    if (buttonMode == true) //If button mode enabled
    {
        if (goForward == true && goBackward == false) //The button is pressed (non-zero speed for the active motor)
        {
            // Serial.println("FWD");
            //Then we need to check which selector is active
            if (buttonModeXAxis == true) //Internal pullup makes it 1 (true) by default, so we look for false (GND = 0)
            { int speed = buttonSpeedinHz*microsteps_list[0]*STEPS_PER_REV;
              stepper_controller.setTargetVelocity(0, speed);}
            if (buttonModeYAxis == true)
            { int speed = buttonSpeedinHz*microsteps_list[1]*STEPS_PER_REV;
              stepper_controller.setTargetVelocity(1, speed);}
            if (buttonModeZAxis == true)
            { int speed = buttonSpeedinHz*microsteps_list[2]*STEPS_PER_REV;
              stepper_controller.setTargetVelocity(2, speed);}
            //no else branch, because one of the three conditions is always true
        }
        else if(goBackward == true && goForward == false) //The button is pressed (non-zero speed for the active motor)
        {
            // Serial.println("BWD");
            //Then we need to check which selector is active
            if (buttonModeXAxis == true) //Internal pullup makes it 1 (true) by default, so we look for false (GND = 0) 
            { int speed = buttonSpeedinHz*microsteps_list[0]*STEPS_PER_REV;
              stepper_controller.setTargetVelocity(0, -1*speed);}
            if (buttonModeYAxis == true)
            { int speed = buttonSpeedinHz*microsteps_list[1]*STEPS_PER_REV;
              stepper_controller.setTargetVelocity(1, -1*speed);}
            if (buttonModeZAxis == true)
            { int speed = buttonSpeedinHz*microsteps_list[2]*STEPS_PER_REV;
              stepper_controller.setTargetVelocity(2, -1*speed);}
            //no else branch, because one of the three conditions is always true
        }
        else //button is released (zero speed for the active motor)
        {
            // Serial.println("Button mode - no button pressed.");
            //Then we need to check which selector is active
            if (buttonModeXAxis == true) //Internal pullup makes it 1 (true) by default, so we look for false (GND = 0) 
            {stepper_controller.setTargetVelocity(0, 0);}
            if (buttonModeYAxis == true)
            {stepper_controller.setTargetVelocity(1, 0);}
            if (buttonModeZAxis == true)
            {stepper_controller.setTargetVelocity(2, 0);}
            //no else branch, because one of the three conditions is always true
        }
    }
}

void cmd_go_relative(MyCommandParser::Argument *args, char *response){
  // Callback for relative movement request "mr motornumber steps"
  int motorNumber = (int)args[0].asInt64;
  int numsteps = (int)args[1].asDouble;
  goRelative(motorNumber, numsteps);
  delay(10);
  bool moving = isMotorMoving(motorNumber);
  snprintf(response, MyCommandParser::MAX_RESPONSE_SIZE, "MO %d %d", (int) motorNumber, moving);
  // Serial.print("MO"); Serial.print(motornumber); Serial.println(moving);
}

void cmd_go_absolute(MyCommandParser::Argument *args, char *response){
  // Callback for absolute movement request "ma motornumber position"
  int motorNumber = (int)args[0].asInt64;
  int pos = (int)args[1].asDouble;
  goAbsolute(motorNumber, pos);
  delay(10);
  bool moving = isMotorMoving(motorNumber);
  snprintf(response, MyCommandParser::MAX_RESPONSE_SIZE, "MO %d %d", (int) motorNumber, moving);
  // Serial.print("MO"); Serial.print(motornumber); Serial.println(moving);
}

void cmd_get_position(MyCommandParser::Argument *args, char *response){
  // Callback for position request "gp motornumber"
  int motorNumber = args[0].asUInt64;
  // Get the position from the drivers
  int current_position = stepper_controller.getActualPosition(motorNumber);
  snprintf(response, MyCommandParser::MAX_RESPONSE_SIZE, "PO %d %d", motorNumber, current_position);
  // Serial.print("PO"); Serial.print(motorNumber); Serial.println(current_position);
}

void cmd_enable_switches_per_motor(MyCommandParser::Argument *args, char *response){
  // Callback for position request "es motornumber state"
  bool state = (bool)args[1].asUInt64;
  int motorNumber = args[0].asUInt64;
  // Switch according to the desired state
  stepper_controller.setSwitchesActiveHigh(); //When switch goes HIGH, it sets an active reference switch signal.
  enableSwitchesPerMotor(motorNumber, state);
  bool Rswitch = stepper_controller.rightSwitchActive(motorNumber);
  bool Lswitch = stepper_controller.leftSwitchActive(motorNumber);
  snprintf(response, MyCommandParser::MAX_RESPONSE_SIZE, "SS %d %d %d", motorNumber, Lswitch, Rswitch);
}

void cmd_enable_switches(MyCommandParser::Argument *args, char *response){
  // Callback for position request "es state"
  bool state = (bool)args[0].asUInt64;
  // Switch according to the desired state
  enableAllSwitches(state);
  snprintf(response, MyCommandParser::MAX_RESPONSE_SIZE, "SE %d", state);
  // Serial.print("SE"); Serial.println(limitSwitchesEnabled);
}

void cmd_enable_advanced_switchstop(MyCommandParser::Argument *args, char *response){
  // Callback for position request "es state"
  bool state = (bool)args[0].asUInt64;
  // Switch according to the desired state
  advancedLimitStop = state;
  snprintf(response, MyCommandParser::MAX_RESPONSE_SIZE, "SA %d", advancedLimitStop);
  // Serial.print("SA"); Serial.println(advancedLimitStop);
}

void cmd_get_switch_state(MyCommandParser::Argument *args, char *response){
  // Callback for position request "ss motornumber"
  int motorNumber = args[0].asUInt64;
  bool Rswitch = stepper_controller.rightSwitchActive(motorNumber);
  bool Lswitch = stepper_controller.leftSwitchActive(motorNumber);
  snprintf(response, MyCommandParser::MAX_RESPONSE_SIZE, "SS %d %d %d", motorNumber, Lswitch, Rswitch);
  // Serial.print("SS"); Serial.print(motorNumber); Serial.print(" "); Serial.print(Lswitch); Serial.print(" "); Serial.println(Rswitch);
}

void cmd_set_microsteps(MyCommandParser::Argument *args, char *response){
  // Callback for position request "ss motornumber"
  int motorNumber = (int)args[0].asUInt64;
  int microsteps = (int)args[1].asUInt64;
  changeMicroSteps(motorNumber, microsteps);
  snprintf(response, MyCommandParser::MAX_RESPONSE_SIZE, "MS %d %d %d", motorNumber, microsteps_list[motorNumber], microsteps_list[motorNumber]*motorsteps_list[motorNumber]);
  // Serial.print("MS"); Serial.print(motorNumber); Serial.println(driver_list[motorNumber].getMicrostepsPerStep());
}

// void cmd_get_microsteps(MyCommandParser::Argument *args, char *response){
//   int motorNumber = (int)args[0].asUInt64;
//   // int microsteps = (int) driver_list[motorNumber].getMicrostepsPerStep();
//   snprintf(response, MyCommandParser::MAX_RESPONSE_SIZE, "MS %d %d %d", motorNumber, microsteps_list[motorNumber], microsteps_list[motorNumber]*STEPS_PER_REV);
//   // Serial.print("MS"); Serial.print(motorNumber); Serial.print(microsteps); Serial.println(microsteps_list[motorNumber]*STEPS_PER_REV);
// }

void cmd_move2d_relative(MyCommandParser::Argument *args, char *response){
  // Callback for position request "mp motornumber1 motornumber2 pos1 pos2"
  int motorNumber1 = (int)args[0].asUInt64;
  int motorNumber2 = (int)args[1].asUInt64;
  long pos1 = (long)args[2].asDouble;
  long pos2 = (long)args[3].asDouble;
  go2dRelative(motorNumber1, motorNumber2, pos1, pos2);
  int newpos1 = stepper_controller.getActualPosition(motorNumber1);
  int newpos2 = stepper_controller.getActualPosition(motorNumber2);
  snprintf(response, MyCommandParser::MAX_RESPONSE_SIZE, "2D %d %d %d %d", motorNumber1, motorNumber2, (int)newpos1, (int)newpos2);
  // Serial.print("2D"); Serial.print(motorNumber1); Serial.print(pos1); Serial.print(motorNumber2); Serial.println(pos2);
}

void cmd_move2d_absolute(MyCommandParser::Argument *args, char *response){
  // Callback for position request "mp motornumber1 motornumber2 pos1 pos2"
  int motorNumber1 = (int)args[0].asUInt64;
  int motorNumber2 = (int)args[1].asUInt64;
  long pos1 = (long)args[2].asDouble;
  long pos2 = (long)args[3].asDouble;
  go2dAbsolute(motorNumber1, motorNumber2, pos1, pos2);
  int newpos1 = stepper_controller.getActualPosition(motorNumber1);
  int newpos2 = stepper_controller.getActualPosition(motorNumber2);
  snprintf(response, MyCommandParser::MAX_RESPONSE_SIZE, "2D %d %d %d %d", motorNumber1, motorNumber2, (int)newpos1, (int)newpos2);
  // Serial.print("2D"); Serial.print(motorNumber1); Serial.print(pos1); Serial.print(motorNumber2); Serial.println(pos2);
}

void cmd_set_move_mode(MyCommandParser::Argument *args, char *response){
  int motorNumber = (int)args[0].asUInt64;
  int mode = (int)args[1].asUInt64;

  setMoveMode(motorNumber, mode);
  snprintf(response, MyCommandParser::MAX_RESPONSE_SIZE, "MM %d %d", motorNumber, mode);
  // Serial.print("MM"); Serial.print(motornum); Serial.println(mode);
}

void cmd_set_maxvelocity(MyCommandParser::Argument *args, char *response){
    int motorNumber = (int)args[0].asUInt64;
    int newmaxspeed = (int)args[1].asUInt64;

    changeMaxVelocities(motorNumber, newmaxspeed, maxaccel_list[motorNumber]);
    int newsetspeed = stepper_controller.getVelocityMaxInHz(motorNumber);

    snprintf(response, MyCommandParser::MAX_RESPONSE_SIZE, "VM %d %d", motorNumber, newsetspeed);
    // Serial.print("VM"); Serial.print(motorNumber); Serial.println(stepper_controller.getVelocityMaxInHz(motorNumber));
}

// void cmd_get_maxvelocity(MyCommandParser::Argument *args, char *response){
//     int motorNumber = (int)args[0].asUInt64;
//     int speed = stepper_controller.getVelocityMaxInHz(motorNumber);

//     snprintf(response, MyCommandParser::MAX_RESPONSE_SIZE, "VM %d %d", motorNumber, speed);
//     // Serial.print("VM"); Serial.print(motorNumber); Serial.println(stepper_controller.getVelocityMaxInHz(motorNumber));
// }

void cmd_set_maxacceleration(MyCommandParser::Argument *args, char *response){
    int motorNumber = (int)args[0].asUInt64;
    int newmaxaccel = (int)args[1].asUInt64;

    changeMaxVelocities(motorNumber, maxspeed_list[motorNumber], newmaxaccel);
    int newaccel = stepper_controller.getAccelerationMaxInHzPerS(motorNumber);

    snprintf(response, MyCommandParser::MAX_RESPONSE_SIZE, "AM %d %d", motorNumber, newaccel);
    // Serial.print("AM"); Serial.print(motorNumber); Serial.println(stepper_controller.getAccelerationMaxInHzPerS(motorNumber));
}

// void cmd_get_maxacceleration(MyCommandParser::Argument *args, char *response){
//     int motorNumber = (int)args[0].asUInt64;
//     int accel = stepper_controller.getAccelerationMaxInHzPerS(motorNumber);

//     snprintf(response, MyCommandParser::MAX_RESPONSE_SIZE, "AM %d %d", motorNumber, accel);
//     // Serial.print("AM"); Serial.print(motorNumber); Serial.println(stepper_controller.getAccelerationMaxInHzPerS(motorNumber));
// }

void cmd_set_targetvelocity(MyCommandParser::Argument *args, char *response){
  size_t motorNumber = (size_t)args[0].asDouble;
  int targetspeed = (int)args[1].asDouble;

  if (targetspeed > 2047){
    targetspeed = 2047;
  }
  stepper_controller.setTargetVelocity(motorNumber, targetspeed);
  int newspeed = stepper_controller.getTargetVelocity(motorNumber);

  snprintf(response, MyCommandParser::MAX_RESPONSE_SIZE, "VT %d %d", motorNumber, newspeed);
  // Serial.print("VT"); Serial.print(motorNumber); Serial.println(stepper_controller.getTargetVelocity(motorNumber));
}

// void cmd_get_targetvelocity(MyCommandParser::Argument *args, char *response){
//   size_t motorNumber = (size_t)args[0].asDouble;
//   int newspeed = stepper_controller.getTargetVelocity(motorNumber);

//   snprintf(response, MyCommandParser::MAX_RESPONSE_SIZE, "VT %d %d", motorNumber, newspeed);
//   // Serial.print("VT"); Serial.print(motorNumber); Serial.println(stepper_controller.getTargetVelocity(motorNumber));
// }

void cmd_get_velocities(MyCommandParser::Argument *args, char *response){
  size_t motorNumber = (size_t)args[0].asDouble;
  int targetspeed = stepper_controller.getTargetVelocity(motorNumber);
  int maxaccel = stepper_controller.getAccelerationMaxInHzPerS(motorNumber);
  int maxspeed = stepper_controller.getVelocityMaxInHz(motorNumber);
  int microsteps = driver_list[motorNumber].getMicrostepsPerStep();

  snprintf(response, MyCommandParser::MAX_RESPONSE_SIZE, "MV %d %d %d %d %d", motorNumber, microsteps, maxspeed, maxaccel, targetspeed);
}

void cmd_home_axis(MyCommandParser::Argument *args, char *response){
  int motorNumber = (int)args[0].asUInt64;
  motorHoming(motorNumber);
  delay(10);
  bool moving = isMotorMoving(motorNumber);
  snprintf(response, MyCommandParser::MAX_RESPONSE_SIZE, "HO %d %d", motorNumber, moving);
  // Serial.print("HO"); Serial.print(motorNumber); Serial.println(moving);
}

void cmd_is_moving(MyCommandParser::Argument *args, char *response){
  int motorNumber = (int)args[0].asUInt64;
  bool moving = isMotorMoving(motorNumber);
  snprintf(response, MyCommandParser::MAX_RESPONSE_SIZE, "MO %d %d", motorNumber, moving);
  // Serial.print("MO"); Serial.print(motorNumber); Serial.println(moving);
}

void cmd_autotune(MyCommandParser::Argument *args, char *response){
  int motorNumber = (int)args[0].asUInt64;

  AutoTuneDriver(motorNumber);

  int auto_scale = driver_list[motorNumber].getPwmScaleAuto();
  int auto_ofs = driver_list[motorNumber].getPwmOffsetAuto();
  int auto_grad = driver_list[motorNumber].getPwmGradientAuto();

  snprintf(response, MyCommandParser::MAX_RESPONSE_SIZE, "AT %d %d %d %d", motorNumber, auto_scale, auto_ofs, auto_grad);
  // Serial.print("MO"); Serial.print(motorNumber); Serial.println(moving);
}

void cmd_set_position(MyCommandParser::Argument *args, char *response){
  int motorNumber = (int)args[0].asUInt64;
  int position = (int)args[1].asDouble;

  stepper_controller.setVelocityMode(motorNumber);//Before resetting switch to velocity mode to stop motors to respond to position values
  stepper_controller.setTargetVelocity(motorNumber, 0); //the parameter V_MAX should be set to zero...???
  delay(100);
  stepper_controller.setActualPosition(motorNumber, position); //set the actual position value
  stepper_controller.setTargetPosition(motorNumber, position); //Target has to be set to ta same so it does not start to go away
  stepper_controller.setRampMode(motorNumber);
  delay(10);

  int newpos = stepper_controller.getActualPosition(motorNumber);
  
  snprintf(response, MyCommandParser::MAX_RESPONSE_SIZE, "PO %d %d", motorNumber, newpos);
  // Serial.print("PO"); Serial.println(stepper_controller.getActualPosition(motorNumber));
}

void serialListener() {
  if (Serial.available()) {
    char line[128];
    size_t lineLength = Serial.readBytesUntil('\n', line, 127);
    line[lineLength] = '\0';

    char response[MyCommandParser::MAX_RESPONSE_SIZE];
    parser.processCommand(line, response);
    Serial.println(response);
  }
}

