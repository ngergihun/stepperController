//3-axis stepper motor controller using the TMC429 ramp generator and three TMC2209 silent stepper motor drivers

/*
Logic:
BUTTON MODE
Select the button mode using the mode selector switch
Select the X, Y or Z axis using the axis selector switch
Use the backward or forward buttons to move the selected axis
The device won't listen to the other two modes
-----
JOYSTICK MODE
Select the joystick mode using the mode selector switch
Move the joystick to move the axes. Axes can move simultaneously
The device won't listen to the other two modes
-----
UART MODE
Select the uart mode using the mode selector switch
Send the corresponding command to the Teensy 4.0 microcontroller
The device won't listen to the other two modes
*/

#include <SPI.h>    //SPI Library
#include <TMC2209.h> //TMC2209 library - Stepper motor config
#include <TMC429.h> //TMC429 library - Ramp generator
#include <Wire.h> //i2C Library
#include <CommandParser.h> //CommandParser Library for parsing incoming UART command


//Instantiate the drivers for the 3 axes
TMC2209 X_driver; //X axis driver and its address set via the MS1, MS2 pins
const TMC2209::SerialAddress SERIAL_ADDRESS_0 = TMC2209::SERIAL_ADDRESS_0; //GND-GND
TMC2209 Y_driver; //Y axis driver and its address set via the MS1, MS2 pins
const TMC2209::SerialAddress SERIAL_ADDRESS_1 = TMC2209::SERIAL_ADDRESS_1; //VCC-GND 
TMC2209 Z_driver; //Z axis driver and its address set via the MS1, MS2 pins
const TMC2209::SerialAddress SERIAL_ADDRESS_2 = TMC2209::SERIAL_ADDRESS_2; //GND-VCC

TMC2209 driver_list[3] = {X_driver, Y_driver, Z_driver};

// Instantiate stepper controller - TMC 429
TMC429 stepper_controller;


//SPI on Teensy 4.0 vs. TMC429
//CS   10 - CSN_C
//MOSI 11 - SDI_C
//MISO 12 - SDO_C
//SCK  13 - SCK_C

//i2c on Teensy 4.0
//SDA 18
//SCL 19

HardwareSerial & serial_stream = Serial1; //1st UART port
//Unlike Arduino, Teensy has different Serial (USB) and Serial1 (UART)
//Serial1 is a hardware serial (UART) port

// Instantiate COMMAND PARSER object
typedef CommandParser<> MyCommandParser;
MyCommandParser parser;

const long SERIAL_BAUD_RATE = 115200; //Baud rate of the UART
//----
const int RX_PIN = 0; //Physical pins of the serial port
const int TX_PIN = 1;

const int RUN_CURRENT_PERCENT = 60; //Percentage current
const int MICROSTEPS_PER_STEP = 16; //Microstepping (16 is more than enough)
const int CHIP_SELECT_PIN = 10; //Chip select pin ??? Is it for the TMC429 ???
const int CLOCK_FREQUENCY_MHZ = 32; //32 MHz - external source, generated by the Teensy on pin 9. See later in the code.
const int STEPS_PER_REV = 400; //Depends on the stepper motor, but typically either 200 (1.8 deg/step) or 400 (0.9 deg/step)
const int MICROSTEPS_PER_REV = STEPS_PER_REV * MICROSTEPS_PER_STEP; //Total steps needed to complete a full turn
const int ACCELERATION_MAX = MICROSTEPS_PER_REV * 4; //Needs to be tested empirically because the mechanism (friction) can affect it
const long ZERO_POSITION = 0; //Shortcut for the zero position
const long VELOCITY_MAX = 2 * MICROSTEPS_PER_REV; //Similarly to the acceleration, this is also empirical!
const long VELOCITY_MIN = 50; //Velocity cannot be 0, see datasheet. Below 50 steps/s the motor shuts down.

// New variables instead of the contants to dynamically change them if needed
long maxspeed = VELOCITY_MAX;
long maxaccel = ACCELERATION_MAX;

//Thread pitches
float xthreadPitch = 2.0; //Pitch of the thread in [mm]. 1 turn of the screw results in '_threadPitch' amount of linear displacement
float ythreadPitch = 2.0;
float zthreadPitch = 2.0;

float threadPitches[3] = {xthreadPitch, ythreadPitch, ythreadPitch};

//Pins
const byte Analog_X_pin = A2; //x-axis readings - A2: 16
const byte Analog_Y_pin = A1; //y-axis readings - A1: 15
const byte Analog_Z_pin = A0; //r-axis readings - A0: 14

const byte forwardButton = 2; //Forward button - when pressed, it drives the selected axis in the positive direction
const byte backwardButton = 3; //Backward button - when pressed, it drives the selected axis in the negative direction
const byte abortButton = 4; //Aborts all movements
const byte redLEDpin = 5; //Red
const byte greenLEDpin = 6; //Green
const byte blueLEDpin = 7; //Blue
const byte clkPin = 9;//32 MHz CLK source for the TMC429 - Clock signal is generated by the Teensy. Set the CPU to 528 MHz!
//Limit switches are treated by the TMC429!

//Variables
int Analog_X = 0; //x-axis value
int Analog_Y = 0; //y-axis value
int Analog_Z = 0; //r-axis value

int Analog_X_AVG = 0; //x-axis value average
int Analog_Y_AVG = 0; //y-axis value average
int Analog_Z_AVG = 0; //r-axis value average

int joystickSpeedX = 0;
int joystickSpeedY = 0;
int joystickSpeedZ = 0;

byte previousGPIOData = 0; //Previous data from GPIO - helps to detect new settings

long receivedAcceleration; //acceleration sent through USB
long receivedVelocity; //velocity sent through USB

bool goForward = false; //forward motion enabled/disabled
bool goBackward = false; //backward motion enabled/disabled
bool abortMovement = false; //Abort button was pressed
bool limitSwitchWasHit = false; //If any of the 6 limit switches were hit (not during homing)
bool buttonModeXAxis = false; //Active axis in button mode is X
bool buttonModeYAxis = false; //Active axis in button mode is Y
bool buttonModeZAxis = false; //Active axis in button mode is Z
bool joystickMode = false; //Joystick mode enabled (3-axis joystick)
bool buttonMode = false; //Button mode enabled (forward and backward button)
bool UARTMode = true; //UART mode enabled (serial port control)
bool updateSettings = false; //Allows the code to update the settings (typically sends new config to the TMC chips)
bool stepperIsMoving = false; //Flag to indicate if a stepper motor is moving
bool limitSwitchActive = false; //If any of the limit switches become active, this status becomes true
//--------------------------------------------------------------------------------------------------------
//--------------------------------------------------------------------------------------------------------
bool limitSwitchesEnabled = false; //Globally enable/disable limit switches for easier testing
//--------------------------------------------------------------------------------------------------------
//--------------------------------------------------------------------------------------------------------
bool debugMode = true;

int limitSwitchID = 0; //ID to see which switch got tripped
int modeSelection = 2; //0 = joystick, 1 = button, 2 = UART
int previousMode = 2; //Previous mode. Helps to keep track of change
unsigned long redLEDTimer = 0; //A variable that stores the elapsed time for the red LED
bool redLEDStatus = false; //Status flag of the red LED.


void setup()
{
  //SERIAL - USB
  Serial.begin(9600);
  Serial.println("TMC249 - TMC2209 - 3-axis motor driver board");
  //Serial COMANNDs setup
  parser.registerCommand("mr", "ud", &cmd_go_relative); // Relative move in STEPs
  parser.registerCommand("ma", "ud", &cmd_go_absolute); // Absolute move in STEPs
  parser.registerCommand("gp", "u", &cmd_get_position); // Get Position
  parser.registerCommand("es", "u", &cmd_enable_switches); // Enable switches
  parser.registerCommand("sm", "uu", &cmd_set_microsteps); // Set microsteps for the given motor driver
  parser.registerCommand("mp", "uudd", &cmd_move2d); // Move in 2d - move in plane
  parser.registerCommand("mm", "u", &cmd_set_move_mode); // Change move mode
  parser.registerCommand("sv","uu", &cmd_set_maxvelocity); // Sets the maximum velocity microsteps/revolution
  parser.registerCommand("sa","uu", &cmd_set_maxacceleration); // Sets the maximum accelaration that the rampgenerator will use to calculate velocity profile
  parser.registerCommand("st","dd", &cmd_set_targetvelocity); // Sets the targetvelocity for velocitymode

  //SERIAL for TMC2209
  Serial1.begin(SERIAL_BAUD_RATE);

  //Start the 32 MHz signal for the TMC429 (don't forget to compile the code with CPU = 528 MHz!)
  analogWriteFrequency(clkPin, CLOCK_FREQUENCY_MHZ*1000000); //Set pin and frequency
  analogWrite(clkPin, 128); //Start signal, 50% duty cycle

  //----------------------------------------------------------------------------
  Wire.begin(); 
  Wire.beginTransmission(0x20);
  Wire.write(0xFF);  //All ON - This is needed to be used with pull-up resistors
  Wire.endTransmission();
  //----------------------------------------------------------------------------
  //PINS
  pinMode(forwardButton, INPUT);
  pinMode(backwardButton, INPUT);
  pinMode(abortButton, INPUT);
  pinMode(redLEDpin, OUTPUT);
  pinMode(greenLEDpin, OUTPUT);
  pinMode(blueLEDpin, OUTPUT);
  //No lights
  analogWrite(redLEDpin, 0);
  analogWrite(greenLEDpin, 0);
  analogWrite(blueLEDpin, 0);
  //----------------------------------------------------------------------------
  InitialValues(); //averaging the values of the 3 analog pins (values from potmeters)
  //----------------------------------------------------------------------------

  //Motor drivers and main controller
  driver_list[0].setup(Serial1, SERIAL_BAUD_RATE, SERIAL_ADDRESS_0);
  driver_list[1].setup(Serial1, SERIAL_BAUD_RATE, SERIAL_ADDRESS_1);
  driver_list[2].setup(Serial1, SERIAL_BAUD_RATE, SERIAL_ADDRESS_2);
  stepper_controller.setup(CHIP_SELECT_PIN, CLOCK_FREQUENCY_MHZ);

  //Limit switch setup----------------------------------------------------------
  if (limitSwitchesEnabled == true)
  {
      stepper_controller.enableRightSwitches(); //Enable stop switches on the right side (far end)
  }  
  //The limit switch module I use is HIGH by default. When pressed, it goes LOW.
  if (limitSwitchesEnabled == true)
  {
      stepper_controller.setSwitchesActiveLow(); //When switch goes HIGH, it sets an active reference switch signal.
  }

  //All drivers setup------------------------------------------------------------
  //Stepper parameters
  //setting up some default values for maximum speed and maximum acceleration
  for (int i = 0; i < 3; i++) 
  {
    // Driver setup
    setupDriver(i, RUN_CURRENT_PERCENT, MICROSTEPS_PER_STEP);
    // Limit switch setup
    if (limitSwitchesEnabled == true)
    {
      enableSwitchesPerMotor(i, limitSwitchesEnabled);
    }
    // Controller setup
    stepper_controller.setLimitsInHz(i, VELOCITY_MIN, VELOCITY_MAX, ACCELERATION_MAX);
    stepper_controller.setVelocityMode(i);//Before overwriting X_ACTUAL choose velocity_mode or hold_mode.
    stepper_controller.setTargetVelocity(i, 0); //...the parameter V_MAX should be set to zero...
    stepper_controller.setActualPosition(i, ZERO_POSITION);
    stepper_controller.setTargetPosition(i, ZERO_POSITION);
    stepper_controller.setSoftMode(i); // Ramp with soft stop

    delay(250);
    driver_list[i].enable();
    driver_list[i].moveUsingStepDirInterface();
    delay(250);
  }

}

void loop()
{
  // serialCommandReceiver(); //Polls the serial port for incoming instructions/commands
  serialListener();
  ReadAnalog(); //Read the joystick
  checkButtons(); //Poll the buttons
  driveMotorWithButtons(); //Send commands to the motor when it is actual
  // 
  readGPIOExpander(); //Read which axis and which control mode is enabled
  sendNewSettings(); //When the user switches to another mode, this function takes care of it. 
  monitorLimitSwitches(); //Keeps monitoring the switches and parks the motors after a limit switch was hit while moving
  checkMotorMovement(); //Check if the motor is moving so we can keep the LEDs properly updated
  //----------------------------------------------------------------------------------------------------------------------
  //This function runs last so everything has the chance to update the statuses
  updateStatusLED();
}

void setupDriver(int motorNumber, int current_percent, int microsteps)
{
  driver_list[motorNumber].setRunCurrent(current_percent);
  driver_list[motorNumber].enableAutomaticCurrentScaling();
  driver_list[motorNumber].enableAutomaticGradientAdaptation();
  driver_list[motorNumber].enableCoolStep();
  driver_list[motorNumber].setMicrostepsPerStep(microsteps);
  driver_list[motorNumber].enableStealthChop(); //This MUST be enabled for correct motor behaviour

}

void changeMicroSteps(int motorNumber, int microsteps)
{
  driver_list[motorNumber].setMicrostepsPerStep(microsteps);
}

void checkMotorMovement() // for the LEDs
{
    for (int i = 0; i < 3; i++)
    {
        //Check each stepper motor if they are moving or not.
        if (stepper_controller.getActualVelocity(i) != 0)
        {
            stepperIsMoving = true;
            //If at least one motor is moving, we can immediately jump out of this loop
            break;
        } 
        else
        {
            stepperIsMoving = false;
        }
    }
}

void updateStatusLED()
{
    //This function follows the status flags and triggers the correspoding LED

    //Abort button is pressed - Blinking Red
    if (abortMovement == true)
    {
        //Serial.println("Red LED, blinking");
        if (millis() - redLEDTimer >= 1000) //Blink Red LED every 1 s
        {
            if (redLEDStatus == false)
            {
                analogWrite(redLEDpin, 255);
                analogWrite(greenLEDpin, 0);
                analogWrite(blueLEDpin, 0);
                redLEDStatus = true;
            }
            else
            {
                analogWrite(redLEDpin, 0); //(no need to update all three because the previous if() did it)
                redLEDStatus = false;
            }
            redLEDTimer = millis();
        }
    }
    
    else if (stepper_controller.communicating() == false)
    {       
        analogWrite(redLEDpin, 255);
        analogWrite(greenLEDpin, 165);
        analogWrite(blueLEDpin, 0);
    }    
    else if(limitSwitchActive == true) //Turn on red LED when any of the limit switches are active
    {
        analogWrite(redLEDpin, 255);
        analogWrite(greenLEDpin, 0);
        analogWrite(blueLEDpin, 0);
    }
    else if (stepperIsMoving == true) //Turn on green LED when any of the motors are moving
    {
        analogWrite(redLEDpin, 0);
        analogWrite(greenLEDpin, 255);
        analogWrite(blueLEDpin, 0);
    }
    else //Standby - Turn on blue LED
    {
        analogWrite(redLEDpin, 0);
        analogWrite(greenLEDpin, 0);  
        analogWrite(blueLEDpin, 255);
    }
}

void readGPIOExpander()
{
    //This function reads the GPIO expander

    //0-1-2 pins: X-Y-Z selector - Always only 1 axis is active
    //3-4-5 pins: Joystick, button, UART selector - Always only 1 mode is active

    byte gpioData = 0; //8-bit reading from the expander

    Wire.requestFrom(0x20, 1); //get 1 byte (8bit) from 0x20 address

    if (Wire.available()) 
    {
        gpioData = Wire.read();
    }
    
    /*
    //This little code prints back the bits that were set for the GPIO module
    Serial.print("GPIO: ");
    for (int i = 7; i >= 0; i--)
    {
        Serial.print((gpioData >> i) & 1); 
        //Print/shift the register bits until the whole byte is printed
    }
    Serial.println();    
    //------------------------------------------------------------------------------
    */
    

    if (previousGPIOData != gpioData)
    {
        previousGPIOData = gpioData; //Update to the most recent reading
        updateSettings = true; //Let the rest of the code know about the new values
        limitSwitchActive = false; //Reset limit switch status here
        Serial.println("Updated switch statuses!");

        //Blink the blue LED to indicate the received change
        analogWrite(redLEDpin, 0);
        analogWrite(blueLEDpin, 0);
        analogWrite(greenLEDpin, 0);

        for (int i = 0; i < 3; i++)
        {
            analogWrite(blueLEDpin, 0);
            delay(50);
            analogWrite(blueLEDpin, 255);
            delay(50);
        } //(100+100)*5 ms = 1000 ms delay
    }

    //Ugly implementation of reading the individual bits

    if (bitRead(gpioData, 0) == 1) //If pin 0 is high
    {
        buttonModeXAxis = false;
    }
    else //Pin 0 is low -> pulled to GND via the switch, so it is ACTIVE!
    {
        buttonModeXAxis = true;
    }

    if (bitRead(gpioData, 1) == 1) //If pin 1 is high
    {
        buttonModeYAxis = false;
    }
    else
    {
        buttonModeYAxis = true;
    }

    if (bitRead(gpioData, 2) == 1) //If pin 2 is high
    {
        buttonModeZAxis = false;
    }
    else
    {
        buttonModeZAxis = true;
    }
    //----------------------------------------------------------------
    if (bitRead(gpioData, 3) == 1) //If pin 3 is high
    {        
        joystickMode = false;
    }
    else
    {
        joystickMode = true;
    }

    if (bitRead(gpioData, 4) == 1) //If pin 4 is high
    {
        buttonMode = false;
    }
    else
    {
        buttonMode = true;
    }

    if (bitRead(gpioData, 5) == 1) //If pin 5 is high
    {
        UARTMode = false;
    }
    else
    {
        UARTMode = true;
    }
    //--------------------------------------------------------------------
}

void ReadAnalog()
{
    if (joystickMode == true) //Only listen to the joystick when the joystick mode is enabled!
    {
        //Reading the 3 potentiometers in the joystick: x, y and r.

        for (int i = 0; i < 10; i++) //Sum 10 readings
        {
            Analog_X += analogRead(Analog_X_pin);
            delayMicroseconds(10);
            Analog_Y += analogRead(Analog_Y_pin);
            delayMicroseconds(10);
            Analog_Z += analogRead(Analog_Z_pin);
            delayMicroseconds(10);
        } //300 us delay + 30x ADC conversion time which is just a few us total

        //Divide the sum of 10 readings by 10
        Analog_X /= 10.0;
        Analog_Y /= 10.0;
        Analog_Z /= 10.0;
                

        //if the value is 20 units away from the average (midpoint), we allow the update of the speed
        //This is a sort of a filter for the inaccuracy of the reading
        if (abs(Analog_X - Analog_X_AVG) > 20)
        {
            joystickSpeedX = (int)(3.8 * (Analog_X - Analog_X_AVG));
            if (debugMode == true){
                Serial.print("joystick-X:"); Serial.println(joystickSpeedX);
                }
            //speed = x
            stepper_controller.setTargetVelocity(0, joystickSpeedX);      
            //The 12 multiplier depends on the mechanism used with the motor. Test it with your system!
            stepperIsMoving = true;                        
        }
        else if (abs(Analog_Y - Analog_Y_AVG) > 20)
        {
            joystickSpeedY = (int)(3.8 * (Analog_Y - Analog_Y_AVG));
            if (debugMode == true){
                Serial.print("joystick-Y:"); Serial.println(joystickSpeedY);
            }

            // speed = y
            stepper_controller.setTargetVelocity(1, joystickSpeedY);
            //The 12 multiplier depends on the mechanism used with the motor. Test it with your system!
            stepperIsMoving = true;
        }
        else if (abs(Analog_Z - Analog_Z_AVG) > 30) //Z works well with these settings
        {
            joystickSpeedZ = (int)(3.8 * (Analog_Z - Analog_Z_AVG));
            if (debugMode == true){
                Serial.print("joystick-Z:"); Serial.println(joystickSpeedZ);
            }

            //speed = z
            stepper_controller.setTargetVelocity(2, joystickSpeedZ);
            //The 5 multiplier depends on the mechanism used with the motor. Test it with your system!
           stepperIsMoving = true;
        }
        else
        {
            if (debugMode == true){
                Serial.println("joystick-standstill");
            }

            //speed = 0 for all motors
            stepper_controller.setTargetVelocity(0, 0); 
            stepper_controller.setTargetVelocity(1, 0);
            stepper_controller.setTargetVelocity(2, 0);
            stepperIsMoving = false;
        }      
        //Reset analog values - necessary, otherwise the sum will be messed up!
        Analog_X = 0;
        Analog_Y = 0;
        Analog_Z = 0;
    }
}

void InitialValues()
{
  //Set the temp values to zero before averaging
  float tempX = 0;
  float tempY = 0;
  float tempZ = 0;
  //----------------------------------------------------------------------------
  //read the analog 50x, then calculate an average.
  //they will be the reference values
  for (int i = 0; i < 50; i++)
  {
    tempX += analogRead(Analog_X_pin);
    delay(10); //allowing a little time between two readings
    tempY += analogRead(Analog_Y_pin);
    delay(10);
    tempZ += analogRead(Analog_Z_pin);
    delay(10);
  }
  //(30 ms + readout(?))*50 times approx 2 seconds
  //----------------------------------------------------------------------------
  Analog_X_AVG =(int)( tempX / 50.0);
  Analog_Y_AVG =(int)(tempY / 50.0);
  Analog_Z_AVG =(int)(tempZ / 50.0); //The float division is casted into int.
  //----------------------------------------------------------------------------
  if (debugMode == true){
    Serial.print("AVG_X: ");
    Serial.println(Analog_X_AVG);
    Serial.print("AVG_Y: ");
    Serial.println(Analog_Y_AVG);
    Serial.print("AVG_Z: ");
    Serial.println(Analog_Z_AVG);
    Serial.println("Calibration is finished!");
  }
}

// STEP UNIT MOVEMENTS ------------------------------------------------------------------------------------------------------------------------------------------------
// RELATIVE -------------------------------------------------------------------------
void goRelative(int motorNumber, long Steps) //Moves the stage by Steps STEP along the X axis relative to the current position
{
  long targetSteps = 0;
  //Get the current position of the X motor in STEPS
  long start_position = stepper_controller.getActualPosition(motorNumber);

  //Add relative movement steps to the current position to get the new target location
  targetSteps = start_position + Steps;

  //send the command to the TMC429
  stepper_controller.setTargetPosition(motorNumber, targetSteps); //Move X (0) to the recently determined target

  // TODO: should we wait until it moves?
  // Serial.print("PO"); Serial.print(motorNumber); Serial.println(current_position);
  // long current_position = stepper_controller.getActualPosition(motorNumber);
}
// ABSOLUTE -------------------------------------------------------------------------
void goAbsolute(int motorNumber, long Steps) //Moves the stage by Steps STEP along the X axis relative to the current position
{
  //send the command to the TMC429
  stepper_controller.setTargetPosition(motorNumber, Steps); //Move X (0) to the recently determined target

  // TODO: should we wait until it moves?
  // Serial.print("PO"); Serial.print(motorNumber); Serial.println(current_position);
  // long current_position = stepper_controller.getActualPosition(motorNumber);
}

void go2dAbsolute(int motorNumber1, int motorNumber2, long Position1, long Position2) //Brings the stage to a predetermined x and y simultaneously position in mm
{
    // long start_position1 = stepper_controller.getActualPosition(motorNumber1);
    // long start_position2 = stepper_controller.getActualPosition(motorNumber2);

    // long delta1 = Position1 - start_position1;
    // long delta2 = Position2 - start_position2;

    // Calculate speeds for the different directions
    // float angle = atan2f((float)delta2, (float)delta1);
    // float v = (float)speed;
    // long speed1 = (long)v*cosf(angle);
    // long speed2 = (long)v*sinf(angle);
    // Serial.print("Speed 1:"); Serial.println(speed1);
    // Serial.print("Speed 2:"); Serial.println(speed2);

    // stepper_controller.setTargetVelocity(motorNumber1,speed1);
    // stepper_controller.setTargetVelocity(motorNumber2,speed2);

    goAbsolute(motorNumber1, Position1);
    delayMicroseconds(10); //a brief delay, but probably, it is unnecessary
    goAbsolute(motorNumber2, Position2);

    // while (stepper_controller.getActualVelocity(motorNumber1) != 0 || stepper_controller.getActualVelocity(motorNumber2) != 0){
    //   delay(10);
    // }
    // Serial.print("New position 1:"); Serial.println(stepper_controller.getActualPosition(motorNumber1));
    // Serial.print("New position 2:"); Serial.println(stepper_controller.getActualPosition(motorNumber2));
}

// REAL COORDINATE MOVEMENTS
// RELATIVE -------------------------------------------------------------------------
void goRelativeReal(int motorNumber, float Position)
{
  long targetSteps = 0;
  // Start position
  long start_position = stepper_controller.getActualPosition(motorNumber);
  //Calculates target move in steps
  long Steps = (long)((Position / threadPitches[motorNumber]) * (MICROSTEPS_PER_REV));
  //Add relative movement steps to the current position to get the new target location
  targetSteps = start_position + Steps;
  //send the command to the TMC429
  stepper_controller.setTargetPosition(motorNumber, targetSteps); //Move X (0) to the recently determined target

}
// ABSOLUTE -------------------------------------------------------------------------
void goAbsoluteReal(int motorNumber, float Position) //Brings the stage to a predetermined x position in mm
{
    //Target position in steps units
    long targetSteps = 0; 
    //convert xPosition (mm) to steps
    targetSteps = (long)((Position / threadPitches[motorNumber]) * (MICROSTEPS_PER_REV)); //Example where target is 5 mm: ( 5 / 2 ) * (256 * 200) = 2.5 * 51200 steps. OK!
    //send the command to the TMC429
    stepper_controller.setTargetPosition(motorNumber, targetSteps); //Move X (0) to the recently determined target
    // TODO: should we wait until it moves?
    // Serial.print("PO"); Serial.print(motorNumber); Serial.println(current_position);
}

// DO WE NEED THIS? - do it from Python ???? if we implement the waitings in the single axis movements then it is useful
void go2dAbsoluteReal(int motorNumber1, int motorNumber2, float Position1, float Position2) //Brings the stage to a predetermined x and y simultaneously position in mm
{
    goAbsoluteReal(motorNumber1, Position1);
    delayMicroseconds(10); //a brief delay, but probably, it is unnecessary
    goAbsoluteReal(motorNumber2, Position2);
    //Simple coding - According to Section 9.4, if the commands arrive fast enough, the motors will move simultaneously
    //It works properly

    //Note: This is a dirty, but easy and working implementation.
    //If we want the motors to arrive at the position at the same time, we need to do the following:
    //1; Select a motor and calculate the time it takes to reach its position with a given ramping
    //2; Use this time to recalculate the ramping of the other motor so its speed and acceleration will be adjusted to the other motor
    //3; Apply the speed and acceleration values, then send the target positions to both drivers as shown above.
}
// --------------------------------------------------------------------------------------------------------------------------------------------------------------------

void sendNewSettings()
{
    //Check the status of the mode selector switch 
    if (updateSettings == true)
    {
        updateSettings = false; //set to false, so this function only performed once
        abortMovement = false; //Reset abort status after changing a mode - abort can be reset by switching mode or axis
        limitSwitchWasHit = false; //Reset the limit switch hit status flag

        if (joystickMode == true)
        {
            //Print a message and switch to velocity mode
            Serial.println("Joystick mode enabled");
            stepper_controller.setVelocityMode(0);
            stepper_controller.setVelocityMode(1);
            stepper_controller.setVelocityMode(2);
            //-----
            //Make the other two modes false/disabled
            buttonMode = false;
            UARTMode = false;
        }
        //-----

        if (buttonMode == true)
        {
            //Print a message and switch to velocity mode
            Serial.println("Button mode enabled");
            stepper_controller.setVelocityMode(0);
            stepper_controller.setVelocityMode(1);
            stepper_controller.setVelocityMode(2);
            //-----
            //Make the other two modes false/disabled
            joystickMode = false;
            UARTMode = false;
        }
        //-----

        if (UARTMode == true)
        {
            //Print a message and switch to soft (or ramp) mode
            Serial.println("UART mode enabled");

            //When switching to UART mode, the target should be set as the actual position (Section 8.1.1)
            long tempPos_x = stepper_controller.getActualPosition(0);
            long tempPos_y = stepper_controller.getActualPosition(1);
            long tempPos_z = stepper_controller.getActualPosition(2);

            stepper_controller.setTargetPosition(0, tempPos_x);
            stepper_controller.setTargetPosition(1, tempPos_y);
            stepper_controller.setTargetPosition(2, tempPos_z);

            stepper_controller.setSoftMode(0); 
            stepper_controller.setSoftMode(1);
            stepper_controller.setSoftMode(2);
            //-----
            //Make the other two modes false/disabled
            buttonMode = false;
            joystickMode = false;
        }
    }
    
}

void motorHoming(int motorNumber) //Motor numbers: x = 0, y = 1, z = 2.
{
        //First of all, make sure that the system is in soft mode!
        if (joystickMode == true || buttonMode == true)
        {
            stepper_controller.setSoftMode(motorNumber);
            //Change the motor to soft mode if it was in velocity mode
        }
        //----
        //Set the motor to a slower speed temporarily, so it won't crash during homing. Pay attention, this value depends on the mechanism!!!
        stepper_controller.setLimitsInHz(motorNumber, VELOCITY_MIN, MICROSTEPS_PER_REV, ACCELERATION_MAX);
        // 

        /* HOMING PROCEDURE
        * 1; Dummy write to X_LATCHED
        * 2; Send the motor towards the negative direction
        * 3; When reaching X2, the position is latched
        * 4; Set the DX_REF_TOLERANCE to allow movement within the x1-x2 range and move to a position < x1 if desired
        * 5; Initialize X_LATCHED again, and latch the position x1 by a motion towards the positive direction
        * 6; When x1 and x2 are determined, ref becomes (x1+x2)/2.
        * 7; Move to X_TARGET = xref and set X_TARGET := 0 and X_ACTUAL := 0;
        */

        //stepper_controller.writeRegister(0, 0b1101, 1000);//x (0) motor, 1101 - DX_REF_TOLERANCE register, 1000 (?) steps. 
        //I am not sure if the above line is correct. 
        //---------------------------------------------------------------------------------------------------------------------------------

        // 1;
        //8.1.15: X_latched. This read-only register stores the actual position upon a change of the reference switch state. 
        stepper_controller.startLatchPositionWaiting(motorNumber); //Waits for the latch position (homing position where the switch were triggered)
        //Notice that if the motor is within x1-x2, it has to move out first because the switch is active.
        //We assume that the motor is not touching the switch right now

        //2;Motor is between xmax and x2 and latch is initialized. We need to go towards -1*xmax (negative direction).

        Serial.println("Homing started."); //Indicate that the homing motion is ongoing    
        stepper_controller.setTargetPosition(motorNumber, -5000000); //Send the motor backwards towards the left switch (REF1)
        //We need to send a ridiculuosly large target position so we can be sure that the motor will eventually reach the switch
        //When the motor is used with a lead screw, enter the equivalent number of steps for the length of the screw "plus a little"

        Serial.print("Latch status: "); //Check the latch status if it is correct
        Serial.println(stepper_controller.latchPositionWaiting(motorNumber)); //Print the latch status for the X (0) motor

        while (stepper_controller.latchPositionWaiting(motorNumber) == 1) //lp bit is set to 0 when the position is latched by the switch
        {
            //Wait here until the switch is latched
            //The motor is running in the meantime while the condition is true
        }//X2 reached after exiting the while()


        Serial.print("Latch status-x2: "); //Print the latch status for the X (0) motor after reaching the switch
        Serial.println(stepper_controller.latchPositionWaiting(motorNumber));

        long x2Pos = stepper_controller.getLatchPosition(motorNumber); //Save the current latch position for later calculations
        Serial.print("Latched-x2: "); Serial.println(x2Pos); //Print the latch position for the x2 position

        //Set a DX_REF_TOLERANCE to allow motion within x1-x2 range.
        stepper_controller.writeRegister(motorNumber, 0b1101, 20000);//x (0) motor, 1101 - DX_REF_TOLERANCE register, 10000 steps. 
        //I am not sure about the number of steps, this could be determined by experiment, but 10k seems fine
        Serial.println("DX tolerance done"); //Indicate the status

        //Initialize X_Latched again to latch the position x1 by a motion to a target position below x1 (between x1 and dx1)
        stepper_controller.startLatchPositionWaiting(motorNumber); //Re-initialize latching
        Serial.println("Latch reinitalized"); //Print status
        stepper_controller.setTargetPosition(motorNumber, (x2Pos + 6000)); //Send the motor backwards towards the left switch (REF1) by a little
        //The stepper goes towards an even more negative position, but short enough so that the switch status is still pressed
        //Again, the number of steps is experimental!

        //Next, we wait until the motor reaches the target position
        while (stepper_controller.atTargetPosition(motorNumber) == 0)
        {
            //Wait here until the target is reached
            //The motor is running in the meantime while the condition is true
        }

        Serial.print("Latch status-x1: "); //Print the latch status. It should be still ready to be latched (unchanged, == 1)
        Serial.println(stepper_controller.latchPositionWaiting(motorNumber));

        long x1Pos = stepper_controller.getLatchPosition(motorNumber); //Save the new latch position and print it
        Serial.print("Latched-x1: "); Serial.println(x1Pos);

        long refPos = (long)((x2Pos + x1Pos) / 2); //Calculate the midpoint between x2 and x1. This is the reference (home) position
        //Keep in mind that the motor here is still stopped and the limit switch is pressed.

        Serial.print("RefPos: "); Serial.println(refPos); //Print the reference position just for checking

        stepper_controller.setTargetPosition(motorNumber, refPos); //Update the target position as the reference position - move the motor to the midpoint

        Serial.println("Moving towards RefPos");
        while (stepper_controller.atTargetPosition(motorNumber) == 0)
        {
            //Wait here until we reach the target position (xref)            
        }
        Serial.println("Arrived at RefPos");

        stepper_controller.setVelocityMode(motorNumber);//Before overwriting X_ACTUAL choose velocity_mode or hold_mode.
        stepper_controller.setTargetVelocity(motorNumber, 0); //...the parameter V_MAX should be set to zero...
        stepper_controller.setActualPosition(motorNumber, 0); //set X (0) position to 0 at the reference position
        stepper_controller.setTargetPosition(motorNumber, 0); //Target has to be set to 0, so the latest value (-xmax) is updated.

        Serial.print("Home: "); Serial.println(stepper_controller.getActualPosition(motorNumber)); //Print the new home position (it should be 0)

        Serial.println("Homing completed"); //Print status message.

        //First of all, make sure that the system is in soft mode!
        if (joystickMode == true || buttonMode == true)
        {
            //Latest mode was velocity mode, so we leave it as-is
        }
        else
        {
            stepper_controller.setSoftMode(motorNumber); //Set back soft mode (mode was UART)
        }

        //Reset initial speed settings
        stepper_controller.setLimitsInHz(motorNumber, VELOCITY_MIN, VELOCITY_MAX, ACCELERATION_MAX);    
}

void enableSwitchMonitoring(bool state)
{
  stepper_controller.enableRightSwitches();
  for (int motorNumber = 0; motorNumber < 3; motorNumber++)
  {
    enableSwitchesPerMotor(motorNumber, true);
  }
  delay(100);
  limitSwitchesEnabled = state;
  Serial.print("SE"); Serial.println(limitSwitchesEnabled);
}

void enableSwitchesPerMotor(int motorNumber, bool state){
  if (state == true){
    stepper_controller.enableLeftSwitchStop(motorNumber); //Motor stops when the speed is negative and REF1 is active
    stepper_controller.enableRightSwitchStop(motorNumber); // Motor stops when the speed is positive and REFR1 is active
    stepper_controller.setReferenceSwitchToLeft(motorNumber); //Homing switch is at the left (negative, motor) side 
    //stepper_controller.enableSwitchSoftStop(motorNumber); // Motor stops softly when hitting the switch - Pick one
    stepper_controller.disableSwitchSoftStop(motorNumber); // Motor stops hard when hitting the switch
  }
  else if (state == false){
    stepper_controller.disableLeftSwitchStop(motorNumber); //Motor stops when the speed is negative and REF1 is active
    stepper_controller.disableRightSwitchStop(motorNumber); // Motor stops when the speed is positive and REFR1 is active
  }
}

void monitorLimitSwitches()
{
    if (limitSwitchesEnabled == true)//Only monitor limit switches if the user enabled it!
    {
        //This function monitors the limit switches while the motor is driven towards its target
        //Notice! All switches must be connected for proper behaviour!
        bool R_limitSwitchStatus = false; //Right limit switch, away from motor/home (positive direction)
        bool L_limitSwitchStatus = false; //Left limit switch, towards motor/home (negative direction)
        int motorNumber = 0;

        //Loop for R
        for (motorNumber = 0; motorNumber < 3; motorNumber++)
        {
            R_limitSwitchStatus = stepper_controller.rightSwitchActive(motorNumber);
            L_limitSwitchStatus = stepper_controller.leftSwitchActive(motorNumber);
            // Serial.print(String(motorNumber) + " ");
            // Serial.print(R_limitSwitchStatus); Serial.println(L_limitSwitchStatus);

            if (R_limitSwitchStatus == true)
            {
                //If any of the switches were activated, we stop 
                //Assumption: no simultaneous motor motion!
                limitSwitchWasHit = true; //Set the status to true
                limitSwitchActive = true;
                Serial.println("Right limit switch " + String(motorNumber) + " was activated");

                updateStatusLED();//Indicate status with red LED

                long tempposition = stepper_controller.getActualPosition(motorNumber);
                //Motor is stopped by the controller here as long as the switch is pressed
                stepper_controller.setTargetPosition(motorNumber, tempposition);

                //Check if this will interfere with homing!!!
                //Switch to velocity mode, so the motor can be controlled by speed
                stepper_controller.setVelocityMode(motorNumber); //Select the motor that triggered the switch
                stepper_controller.setTargetVelocity(motorNumber, -500); //Send it backwards with an arbitrary speed

                while (stepper_controller.rightSwitchActive(motorNumber) == true) //while the switch is active
                {
                    //This while() runs while the switch is pressed
                }

                stepper_controller.setTargetVelocity(motorNumber, 0); //Stop the motor by setting its speed to 0

                //These two lines make sure that the motor is stopped and it does not try to go towards the previously set target
                tempposition = stepper_controller.getActualPosition(motorNumber);
                stepper_controller.setTargetPosition(motorNumber, tempposition);

                stepper_controller.setSoftMode(motorNumber); //Set the motor back to soft mode (position mode)

                break; //Exit the for loop so the loop can inspect the other switches as well
            }
            else {
              limitSwitchActive = false;
              limitSwitchWasHit = false;
            }

            if (L_limitSwitchStatus == true)
            {
                //If any of the switches were activated, we stop 
                //Assumption: no simultaneous motor motion!
                limitSwitchWasHit = true; //Set the status to true
                limitSwitchActive = true;
                Serial.println("Left limit switch " + String(motorNumber) + " was activated");

                updateStatusLED();

                long tempposition = stepper_controller.getActualPosition(motorNumber);
                //Motor is stopped by the controller here as long as the switch is pressed
                stepper_controller.setTargetPosition(motorNumber, tempposition);

                //Check if this will interfere with homing!!!

                //Switch to velocity mode, so the motor can be controlled by speed
                stepper_controller.setVelocityMode(motorNumber); //Select the motor that triggered the switch
                stepper_controller.setTargetVelocity(motorNumber, 500); //Send it forwards with an arbitrary speed

                while (stepper_controller.leftSwitchActive(motorNumber) == true) //while the switch is active
                {
                    //This while() runs while the switch is pressed
                }

                stepper_controller.setTargetVelocity(motorNumber, 0); //Stop the motor by setting its speed to 0

                //These two lines make sure that the motor is stopped and it does not try to go towards the previously set target
                tempposition = stepper_controller.getActualPosition(motorNumber);
                stepper_controller.setTargetPosition(motorNumber, tempposition);

                stepper_controller.setSoftMode(motorNumber); //Set the motor back to soft mode (position mode)

                break; //Exit the for loop so the loop can inspect the other switches as well
            }
            else {
              limitSwitchActive = false;
              limitSwitchWasHit = false;
            }
        }
    }

}

float calculatePositionMM(long stepperMotorSteps)
{
  //Take the position of the motor in number of steps and convert it into millimetres
  float positionMM = 0;

  positionMM = (float)((stepperMotorSteps / MICROSTEPS_PER_REV) * xthreadPitch);
  //ex: (3200/1600) * 2 mm = 2*2 mm = 4 mm

  //The function could be used globally if all thread pitches and microsteps_per_rev are the same
  //As of now, this assumption is valid

   return positionMM; //return the calculated position in millimetres
}

long calculatePositionSteps(float stepperMotorMM)
{
  //Take the motor position (typically a target) in mm and convert it into steps

  long positionSteps = 0;

  positionSteps = (long)((stepperMotorMM / xthreadPitch) * MICROSTEPS_PER_REV);
  //ex: (8 mm / 2 mm) * 1600 steps = 4 * 1600 steps / 6400 steps

  //The function could be used globally if all thread pitches and microsteps_per_rev are the same
  //As of now, this assumption is valid

  return positionSteps; //return the calculated position in steps
}

void checkButtons()
{
    if (buttonMode == true) //Only listen to these 2 buttons in button mode
    {
        if (digitalRead(forwardButton) == 0) //Forward button is pressed
        {
            goForward = true;
            stepperIsMoving = true;
        }
        else if(digitalRead(backwardButton) == 0) //Backward button is pressed
        {
            goBackward = true;
            stepperIsMoving = true;
        }
        else //Forward or backward button is released
        {
            goBackward = false;
            goForward = false;
            stepperIsMoving = false;
        }
    }

   //----
   //We always listen to the abort button!    
   if(digitalRead(abortButton) == 0) //Abort button is pressed, this should be a 2-state (clicking) button, not a pushbutton!
   {
       Serial.println("Abort button was pressed!");

       if (stepperIsMoving == true) //Only abort movement when there's any
       {
           Serial.println("---STOP---");
           abortMovement = true;
           stepperIsMoving = false;
       }
       else //Otherwise, an alternative function is assigned to the abort button which is homing
       {
            Serial.println("Homing via abort button");
            if (buttonModeXAxis == true) //Internal pullup makes it 1 (true) by default, so we look for false (GND = 0) 
            {
            Serial.println("Homing X");
            motorHoming(0); //Home X
            }
            if (buttonModeYAxis == true) //Internal pullup makes it 1 (true) by default, so we look for false (GND = 0) 
            {
            Serial.println("Homing Y");
            motorHoming(1); //Home Y
            }
            if (buttonModeZAxis == true) //Internal pullup makes it 1 (true) by default, so we look for false (GND = 0) 
            {
            Serial.println("Homing Z");
            motorHoming(2); //Home Z
            }
            Serial.println("Homing is completed for all three axes!");
       }
   }
   else //Abort button is released
   {
      abortMovement = false;
   }  
   
}

void driveMotorWithButtons()
{
    //--------------------------------------------------------------------------------------------------------------------
    //Driving the motor forwards
    //Abort function is not used here since the motors immediately stop when the button is released
    //--------------------------------------------------------------------------------------------------------------------
    if (buttonMode == true) //If button mode enabled
    {
        if (goForward == true && goBackward == false) //The button is pressed (non-zero speed for the active motor)
        {
            Serial.println("FWD");
            //Then we need to check which selector is active
            if (buttonModeXAxis == true) //Internal pullup makes it 1 (true) by default, so we look for false (GND = 0) 
            {
                stepper_controller.setTargetVelocity(0, 500); //X (0) motor at 500 steps/s speed
                //The user has to pick a speed here
            }
            //---
            if (buttonModeYAxis == true)
            {
                stepper_controller.setTargetVelocity(1, 500); //Y (1) motor at 500 steps/s speed
                //The user has to pick a speed here
            }

            if (buttonModeZAxis == true)
            {
                stepper_controller.setTargetVelocity(2, 500); //Z (2) motor at 500 steps/s speed
                //The user has to pick a speed here
            }

            //no else branch, because one of the three conditions is always true

        }
        else if(goBackward == true && goForward == false) //The button is pressed (non-zero speed for the active motor)
        {
            Serial.println("BWD");
            //Then we need to check which selector is active
            if (buttonModeXAxis == true) //Internal pullup makes it 1 (true) by default, so we look for false (GND = 0) 
            {
                stepper_controller.setTargetVelocity(0, -500); //X (0) motor at -500 steps/s speed
                //The user has to pick a speed here
            }
            if (buttonModeYAxis == true)
            {
                stepper_controller.setTargetVelocity(1, -500); //Y (1) motor at -500 steps/s speed
                //The user has to pick a speed here
            }

            if (buttonModeZAxis == true)
            {
                stepper_controller.setTargetVelocity(2, -500); //Z (2) motor at -500 steps/s speed
                //The user has to pick a speed here
            }

            //no else branch, because one of the three conditions is always true

        }
        else //button is released (zero speed for the active motor)
        {
            Serial.println("Button mode - no button pressed.");
            //Then we need to check which selector is active
            if (buttonModeXAxis == true) //Internal pullup makes it 1 (true) by default, so we look for false (GND = 0) 
            {
                stepper_controller.setTargetVelocity(0, 0); //X (0) motor at 0 steps/s speed                
            }
            //---
            if (buttonModeYAxis == true)
            {
                stepper_controller.setTargetVelocity(1, 0); //Y (1) motor at 0 steps/s speed
            }

            if (buttonModeZAxis == true)
            {
                stepper_controller.setTargetVelocity(2, 0); //Z (2) motor at 0 steps/s speed
            }
            //no else branch, because one of the three conditions is always true
        }
    }
}

void cmd_go_relative(MyCommandParser::Argument *args, char *response){
  // Callback for relative movement request "mr motornumber steps"
  long motornumber = (long)args[0].asInt64;
  int numsteps = (int)args[1].asDouble;

  goRelative(motornumber, numsteps);

}

void cmd_go_absolute(MyCommandParser::Argument *args, char *response){
  // Callback for absolute movement request "ma motornumber position"
  long motornumber = (long)args[0].asInt64;
  int pos = (int)args[1].asDouble;

  goAbsolute(motornumber, pos);

}

void cmd_get_position(MyCommandParser::Argument *args, char *response){
  // Callback for position request "gp motornumber"
  long motorNumber = (long)args[0].asUInt64;
  // Get the position from the drivers
  int current_position = stepper_controller.getActualPosition(motorNumber);
  Serial.print("PO"); Serial.print(motorNumber); Serial.println(current_position);
}

void cmd_enable_switches(MyCommandParser::Argument *args, char *response){
  // Callback for position request "es state"
  bool state = (bool)args[0].asUInt64;
  // Switch according to the desired state
  enableSwitchMonitoring(state);
}

void cmd_get_switch_state(MyCommandParser::Argument *args, char *response){
  // Callback for position request "ss motornumber"
  bool state = (bool)args[0].asUInt64;
  Serial.print("SS"); Serial.println(state);
}

void cmd_set_microsteps(MyCommandParser::Argument *args, char *response){
  // Callback for position request "ss motornumber"
  int motorNumber = (int)args[0].asUInt64;
  int microsteps = (int)args[1].asUInt64;
  changeMicroSteps(motorNumber, microsteps);
  Serial.print("MS"); Serial.print(motorNumber); Serial.println(driver_list[motorNumber].getMicrostepsPerStep());
}

void cmd_move2d(MyCommandParser::Argument *args, char *response){
  // Callback for position request "mp motornumber1 motornumber2 pos1 pos2"
  int motorNumber1 = (int)args[0].asUInt64;
  int motorNumber2 = (int)args[1].asUInt64;

  long pos1 = (long)args[2].asDouble;
  long pos2 = (long)args[3].asDouble;

  go2dAbsolute(motorNumber1, motorNumber2, pos1, pos2);
  Serial.print("PO"); Serial.print(motorNumber1); Serial.print(stepper_controller.getActualPosition(motorNumber1)); Serial.print(motorNumber2); Serial.println(stepper_controller.getActualPosition(motorNumber2));
}

void cmd_set_move_mode(MyCommandParser::Argument *args, char *response){
  int mode = (int)args[0].asUInt64;

  for (int motornum = 0; motornum < 3; motornum++) 
  {
    switch (mode){
      case 0:
        stepper_controller.setSoftMode(motornum); // exponential acceleration at start and finish
        break;
      case 1:
        stepper_controller.setRampMode(motornum); // linear acceleration (speed change)
        break;
      case 2:
        stepper_controller.setVelocityMode(motornum); // constant target velocity is maintained
        break;
      case 3:
        stepper_controller.setHoldMode(motornum); // brutally goes wherever you want it - HULK MODE
        break;
    }
  }

  Serial.print("MO"); Serial.println(mode);
}

void cmd_set_maxvelocity(MyCommandParser::Argument *args, char *response){
    int motorNumber = (int)args[0].asUInt64;
    maxspeed = (long)args[1].asUInt64;

    stepper_controller.setLimitsInHz(motorNumber, VELOCITY_MIN, maxspeed, maxaccel);
    Serial.print("VMAX"); Serial.print(motorNumber); Serial.println(stepper_controller.getVelocityMaxInHz(motorNumber));
}

void cmd_set_maxacceleration(MyCommandParser::Argument *args, char *response){
    int motorNumber = (int)args[0].asUInt64;
    maxaccel = (long)args[1].asUInt64;

    stepper_controller.setLimitsInHz(motorNumber, VELOCITY_MIN, maxspeed, maxaccel);
    Serial.print("AMAX"); Serial.print(motorNumber); Serial.println(stepper_controller.getAccelerationMaxInHzPerS(motorNumber));
}

void cmd_set_targetvelocity(MyCommandParser::Argument *args, char *response){
  size_t motorNumber = (size_t)args[0].asDouble;
  int targetspeed = (int)args[1].asDouble;

  if (targetspeed > 2047){
    targetspeed = 2047;
  }
  stepper_controller.setTargetVelocityNew(motorNumber, targetspeed);
  Serial.print("VT"); Serial.print(motorNumber); Serial.println(stepper_controller.getTargetVelocity(motorNumber));
}

void serialListener() {
  if (Serial.available()) {
    char line[128];
    size_t lineLength = Serial.readBytesUntil('\n', line, 127);
    line[lineLength] = '\0';

    char response[MyCommandParser::MAX_RESPONSE_SIZE];
    parser.processCommand(line, response);
    // Serial.println(response);
  }
}